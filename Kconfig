## Kconfig
```kconfig
# Kconfig - Root configuration file for Nexus Embedded Platform
#
# This is the main entry point for the Kconfig-based configuration system.
# It includes build, platform, toolchain, HAL, and OSAL configuration files.

mainmenu "Nexus Embedded Platform Configuration"

#-----------------------------------------------------------------------------
# Build and Toolchain Configuration
#-----------------------------------------------------------------------------

source "cmake/Kconfig"

#-----------------------------------------------------------------------------
# Platform Selection and Configuration
#-----------------------------------------------------------------------------

source "platforms/Kconfig"
source "boards/Kconfig"
source "cmake/Kconfig.firmware"

#-----------------------------------------------------------------------------
# HAL Layer Configuration
#-----------------------------------------------------------------------------

source "hal/Kconfig"

#-----------------------------------------------------------------------------
# OSAL Configuration
#-----------------------------------------------------------------------------

source "osal/Kconfig"
source "services/Kconfig"

#-----------------------------------------------------------------------------
# Framework Layer Configuration (Future Expansion)
#-----------------------------------------------------------------------------

source "framework/Kconfig"

#-----------------------------------------------------------------------------
# Middleware Configuration (Future Expansion)
#-----------------------------------------------------------------------------

# source "middleware/Kconfig"

#-----------------------------------------------------------------------------
# Applications Configuration
#-----------------------------------------------------------------------------
```

## applications/Kconfig
```kconfig
#-----------------------------------------------------------------------------
# Applications Configuration
#-----------------------------------------------------------------------------
# This file defines configuration options for example applications.
# Generic applications can also execute against the Native reference board.
#-----------------------------------------------------------------------------


menu "Example Applications"

config BUILD_APP_BLINKY
    bool "Build Blinky Example"
    default y
    help
      Basic LED blinky example demonstrating GPIO control.

      Features:
        - GPIO initialization and control
        - Basic delay functions
        - Minimal resource usage

      Suitable for: All platforms
      Requirements: GPIO peripheral

config BUILD_APP_SHELL_DEMO
    bool "Build Shell Demo"
    default y
    depends on PLATFORM_NATIVE && FRAMEWORK_SHELL
    help
      Native standard-stream console with a real Shell framework backend,
      one board LED, checked command outcomes and a finite --smoke mode.
      MCU consoles require an explicit product transport binding and are
      not provided by this reference application.

config BUILD_APP_CONFIG_DEMO
    bool "Build Config Demo"
    depends on FRAMEWORK_CONFIG
    default y
    help
      Finite checked volatile parameter-store demonstration: typed values,
      namespace isolation, JSON and binary v2 round trips and explicit error
      outcomes. Persistence requires a separate backend and is not claimed.

config BUILD_APP_STM32_BLINKY
    bool "Build STM32 Minimal Blinky"
    default y if PLATFORM_STM32
    depends on PLATFORM_STM32
    help
      Direct ST HAL GPIO demonstration for the STM32F4DISCOVERY PD12 LED.
      This uses the selected SDK, startup, clock and board wiring. Build
      evidence does not establish boot or timing on a physical board.

config BUILD_APP_STM32_CONFIG_TEST
    bool "Build STM32 Configuration Test"
    default y if PLATFORM_STM32
    depends on PLATFORM_STM32
    help
      Read-only STM32F407 diagnostics using shared platform startup:
      effective configuration, observed clock/identity, NVIC and heartbeat.
      The product must provide a printf transport; no Flash erase/program
      or peripheral qualification is performed by this application.

config BUILD_APP_FREERTOS_DEMO
    bool "Build FreeRTOS Demo"
    default y if OSAL_FREERTOS
    depends on OSAL_FREERTOS || OSAL_NATIVE
    help
      OSAL adapter demonstration with tasks and bounded resources.

      Features:
        - Multi-task creation and management
        - Mutex for resource protection
        - Semaphore for task synchronization
        - Message queue for inter-task communication

      Requires Native or FreeRTOS OSAL; baremetal tasks are unsupported.

#-----------------------------------------------------------------------------
# Application Common Settings
#-----------------------------------------------------------------------------

menu "Application Common Settings"

config APP_STACK_SIZE
    hex "Application stack size"
    default 0x1000
    range 0x400 0x10000
    help
      Linker reservation for the CPU main/exception stack, in bytes.
      OSAL task stacks use their independently bounded backend pools.

      Recommended values:
        - Simple applications: 0x400 (1KB)
        - Standard applications: 0x1000 (4KB)
        - Complex applications: 0x2000 (8KB)

config APP_HEAP_SIZE
    hex "Application heap size"
    default 0x2000
    range 0x200 0x100000
    help
      Linker reservation for the C runtime heap, in bytes. FreeRTOS's
      management heap and static OSAL object pools have separate budgets.

      Recommended values:
        - Minimal: 0x200 (512B)
        - Standard: 0x2000 (8KB)
        - Large: 0x10000 (64KB)

endmenu

#-----------------------------------------------------------------------------
# Post-Build Options
#-----------------------------------------------------------------------------

menu "Post-Build Options"

config APP_GENERATE_BIN
    bool "Generate binary (.bin) files"
    default y
    help
      Generate binary files for flashing.
      Uses objcopy to create .bin files from ELF.

config APP_GENERATE_HEX
    bool "Generate Intel HEX (.hex) files"
    default y
    help
      Generate Intel HEX files for flashing.
      Uses objcopy to create .hex files from ELF.

config APP_GENERATE_MAP
    bool
    default y
    help
      A detailed linker map is mandatory firmware evidence. It records
      memory usage and symbol locations for each application.

config APP_PRINT_SIZE
    bool "Print size information"
    default y
    help
      Print memory usage information after build.
      Shows text, data, and bss section sizes.

config APP_PRINT_MEMORY_USAGE
    bool "Print detailed memory usage"
    default y
    help
      Print detailed memory region usage.
      Shows usage of FLASH, RAM, and other memory regions.

endmenu

endmenu
```

## boards/Kconfig
```kconfig
choice
    prompt "Reference board"
    default BOARD_NATIVE_REFERENCE if PLATFORM_NATIVE
    default BOARD_STM32F4DISCOVERY if PLATFORM_STM32 && STM32F407VG
    default BOARD_STM32F407_QIMING_V31 if PLATFORM_STM32 && STM32F407ZG
    default BOARD_STM32F407VE_SKY_QINGCHUN if PLATFORM_STM32 && STM32F407VE
    default BOARD_GD32F470_LIANGSHAN if PLATFORM_GD32F470 && GD32F470ZG
config BOARD_EXTERNAL
    bool "External board package (NEXUS_BOARD_DIR required)"
config BOARD_NATIVE_REFERENCE
    bool "Native simulation"
    depends on PLATFORM_NATIVE
config BOARD_STM32F4DISCOVERY
    bool "STM32F4DISCOVERY MB997 (hardware verification pending)"
    depends on PLATFORM_STM32 && STM32F407VG
config BOARD_STM32F407_QIMING_V31
    bool "Qiming Xinxin STM32F407ZGT6 high-spec V3.1"
    depends on PLATFORM_STM32 && STM32F407ZG
config BOARD_STM32F407VE_SKY_QINGCHUN
    bool "Sky youth STM32F407VET6"
    depends on PLATFORM_STM32 && STM32F407VE
config BOARD_GD32F470_LIANGSHAN
    bool "Liangshan GD32F470ZGT6 (physical verification pending)"
    depends on PLATFORM_GD32F470 && GD32F470ZG
endchoice
config BOARD_NAME
    string
    default "$(NEXUS_EXTERNAL_BOARD_NAME)" if BOARD_EXTERNAL
    default "native-reference" if BOARD_NATIVE_REFERENCE
    default "stm32f4discovery-mb997" if BOARD_STM32F4DISCOVERY
    default "stm32f407zg-qiming-v31" if BOARD_STM32F407_QIMING_V31
    default "stm32f407ve-sky-qingchun" if BOARD_STM32F407VE_SKY_QINGCHUN
    default "gd32f470zg-liangshan" if BOARD_GD32F470_LIANGSHAN
```

## cmake/Kconfig.build
```kconfig
choice
    prompt "Build mode (selected by CMake)"
    default BUILD_TYPE_DEBUG
config BUILD_TYPE_DEBUG
    bool "Debug"
config BUILD_TYPE_RELEASE
    bool "Release"
config BUILD_TYPE_MINSIZEREL
    bool "MinSizeRel"
config BUILD_TYPE_RELWITHDEBINFO
    bool "RelWithDebInfo"
endchoice
config BUILD_TYPE
    string
    default "Debug" if BUILD_TYPE_DEBUG
    default "Release" if BUILD_TYPE_RELEASE
    default "MinSizeRel" if BUILD_TYPE_MINSIZEREL
    default "RelWithDebInfo" if BUILD_TYPE_RELWITHDEBINFO
config BUILD_TESTS
    bool "Build host tests"
    default y
    depends on PLATFORM_NATIVE
config BUILD_CONTRACTS
    bool "Build common platform contract fixtures"
    default n
config ENABLE_COVERAGE
    bool "GCC host coverage"
    default n
    depends on PLATFORM_NATIVE
config ENABLE_SANITIZERS
    bool "Address and undefined behavior sanitizers"
    default n
    depends on PLATFORM_NATIVE
```
