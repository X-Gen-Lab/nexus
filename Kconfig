## osal/Kconfig
```kconfig
# osal/Kconfig - Operating System Abstraction Layer configuration

menu "Operating System Abstraction Layer"

choice
    prompt "OSAL Backend"
    default OSAL_NATIVE if PLATFORM_NATIVE
    default OSAL_BAREMETAL
    help
      Select the operating system backend for OSAL.

      Available backends:
      - Bare-metal: Control loop and hardware ISRs, no task scheduler
      - FreeRTOS: Popular real-time operating system
      - Native: PC simulation backend

config OSAL_BAREMETAL
    bool "Bare-metal (No OS)"
    help
      Bare-metal implementation without RTOS.
      Provides bounded synchronization for one control thread and hardware
      ISRs. Tasks, a dynamic OSAL heap and software timers are unsupported.

config OSAL_FREERTOS
    bool "FreeRTOS Cortex-M4F port"
    depends on PLATFORM_STM32 || PLATFORM_GD32F470
    help
      FreeRTOS real-time operating system.
      Industry-standard RTOS with wide platform support.

config OSAL_NATIVE
    bool "Native host backend"
    depends on PLATFORM_NATIVE
    help
      Native PC simulation backend.
      For development and testing on PC.

endchoice

# OSAL backend name string
config OSAL_BACKEND_NAME
    string
    default "baremetal" if OSAL_BAREMETAL
    default "freertos" if OSAL_FREERTOS
    default "native" if OSAL_NATIVE

# System parameters configuration
menu "System Parameters"

config OSAL_MAX_TASKS
    int "Maximum task handles"
    default 16 if PLATFORM_NATIVE
    default 8
    range 1 64

config OSAL_MAX_MUTEXES
    int "Maximum mutex handles"
    default 16 if PLATFORM_NATIVE
    default 8
    range 1 64

config OSAL_MAX_SEMS
    int "Maximum semaphore handles"
    default 16 if PLATFORM_NATIVE
    default 8
    range 1 64

config OSAL_MAX_QUEUES
    int "Maximum queue handles"
    default 8 if PLATFORM_NATIVE
    default 4
    range 1 32

config OSAL_MAX_EVENTS
    int "Maximum event handles"
    default 8 if PLATFORM_NATIVE
    default 4
    range 1 32

config OSAL_MAX_TIMERS
    int "Maximum software timer handles"
    default 8 if PLATFORM_NATIVE
    default 4
    range 1 32

config OSAL_MAX_QUEUE_ITEM_SIZE
    int "Maximum queue item size (bytes)"
    default 1024
    range 16 4096
    help
      Bound each queue copy. The default includes the asynchronous logging
      entry and its metadata; oversized items fail before allocation.

config OSAL_MAX_QUEUE_BYTES
    int "Maximum allocation for one queue (bytes)"
    default 65536 if PLATFORM_NATIVE
    default 8192
    range 256 1048576
    help
      Product memory budget, independently checked before multiplication.

config OSAL_TICK_RATE_HZ
    int "System tick rate (Hz)" if OSAL_FREERTOS
    default 1000 if OSAL_FREERTOS
    default 1000
    range 1000 1000 if PLATFORM_NATIVE || ((PLATFORM_STM32 || PLATFORM_GD32F470) && OSAL_FREERTOS)
    range 100 10000
    help
      System tick rate in Hz.
      Higher rates provide better timing resolution but increase overhead.
      The F407 reference shares the 1 ms HAL time base and currently requires
      exactly 1,000 Hz. Other rates require an independent HAL time base.

config OSAL_HEAP_SIZE
    int "FreeRTOS heap size (bytes)"
    depends on OSAL_FREERTOS
    default 32768 if OSAL_FREERTOS
    default 65536
    range 4096 1048576
    help
      Total heap size in bytes.
      Used for dynamic memory allocation.

config OSAL_MAX_PRIORITIES
    int "Maximum priority levels"
    default 32 if OSAL_FREERTOS
    default 16
    range 8 32
    depends on OSAL_FREERTOS
    help
      Maximum number of priority levels.
      More levels provide finer control but increase overhead.

endmenu

# Include backend-specific configuration files
# Baremetal has no scheduler configuration or software task limits.
rsource "adapters/freertos/Kconfig"

endmenu
```

## osal/adapters/freertos/Kconfig
```kconfig
# osal/adapters/freertos/Kconfig - FreeRTOS OSAL configuration

if OSAL_FREERTOS

menu "FreeRTOS Configuration"

config OSAL_FREERTOS_TASK_STACK_BYTES
    int "Static storage bytes per OSAL task stack"
    default 2048
    range 512 16384
    help
      Each OSAL task has a dedicated static kernel control block and stack.
      Larger create requests fail rather than allocate from the kernel heap.
      Total reserved stack bytes scale with OSAL_MAX_TASKS.

config OSAL_FREERTOS_QUEUE_STORAGE_BYTES
    int "Static payload bytes per OSAL queue"
    default 1024
    range 128 16384
    help
      Each queue has this fixed payload capacity, a static kernel control
      block and OSAL_MAX_QUEUE_ITEM_SIZE scratch bytes for overwrite mode.
      Total reserved bytes scale with OSAL_MAX_QUEUES. Product admission
      checks both this limit and OSAL_MAX_QUEUE_BYTES.

config FREERTOS_USE_PREEMPTION
    bool
    default y
    help
      Required by the supported OSAL scheduling contract. Cooperative
      scheduling is not implemented by this backend.

config FREERTOS_USE_TIMERS
    bool
    default y
    help
      The timer daemon is required for timer lifetime acknowledgements.
      Disabling it is not supported by this backend.

config FREERTOS_TIMER_TASK_PRIORITY
    int "Timer task priority"
    default 2
    range 0 31
    depends on FREERTOS_USE_TIMERS
    help
      Priority of the timer service task.

config FREERTOS_TIMER_QUEUE_LENGTH
    int "Timer queue length"
    default 10
    range 1 100
    depends on FREERTOS_USE_TIMERS
    help
      Length of the timer command queue.

endmenu

endif # OSAL_FREERTOS
```

## platforms/Kconfig
```kconfig
# Maintained platform assembly. Hardware capabilities are defined by each SoC.
menu "Platform Configuration"

choice
    prompt "Target Platform"
    default PLATFORM_NATIVE

config PLATFORM_NATIVE
    bool "Native host model"
    help
      Host execution for software tests; it does not qualify MCU hardware.

config PLATFORM_STM32
    bool "STM32F407 platform"
    help
      Maintained STM32F407 VE, VG and ZG Cortex-M4 configurations only.

config PLATFORM_GD32F470
    bool "GD32F470ZG platform"
    help
      Maintained GD32F470ZGT6 Cortex-M4 configuration.

endchoice

config PLATFORM_NAME
    string
    default "native" if PLATFORM_NATIVE
    default "stm32" if PLATFORM_STM32
    default "gd32f470" if PLATFORM_GD32F470

if PLATFORM_NATIVE
rsource "native/Kconfig"
endif
if PLATFORM_STM32
rsource "stm32/Kconfig"
endif
if PLATFORM_GD32F470
rsource "gd32f470/Kconfig"
endif

endmenu
```
