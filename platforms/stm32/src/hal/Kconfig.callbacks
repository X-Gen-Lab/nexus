## platforms/stm32/src/hal/spi/Kconfig
```kconfig
# STM32 SPI Driver Configuration
# This file is sourced from platforms/stm32/src/hal/Kconfig
# when STM32_SPI_ENABLE is selected

config STM32_SPI_MAX_INSTANCES
    int "Maximum number of SPI instances"
    default 6
    range 1 8
    help
      Maximum number of SPI instances supported by the platform.
      This determines the size of the SPI instance array.

config STM32_SPI_USE_OSAL
    bool "Use OSAL for thread safety"
    default n
    depends on OSAL_ENABLE
    help
      Enable OSAL integration for SPI driver.
      When enabled, SPI operations are protected by mutexes
      and DMA transfers use semaphores for synchronization.

      This is required for multi-threaded applications using RTOS.
      For bare-metal applications, this can be disabled.

config STM32_SPI_USE_DMA
    bool "Enable DMA support for SPI"
    default n
    help
      Enable DMA (Direct Memory Access) support for SPI transfers.
      DMA can significantly reduce CPU load for large data transfers.

      Note: DMA support requires proper DMA channel configuration
      and may require OSAL for synchronization.

config STM32_SPI_DEFAULT_MODE
    int "Default SPI mode"
    default 0
    range 0 3
    help
      Default SPI mode (CPOL/CPHA combination).
      0 = Mode 0 (CPOL=0, CPHA=0)
      1 = Mode 1 (CPOL=0, CPHA=1)
      2 = Mode 2 (CPOL=1, CPHA=0)
      3 = Mode 3 (CPOL=1, CPHA=1)

config STM32_SPI_DEFAULT_PRESCALER
    int "Default baud rate prescaler"
    default 4
    help
      Default baud rate prescaler for SPI.
      0 = /2, 1 = /4, 2 = /8, 3 = /16, 4 = /32, 5 = /64, 6 = /128, 7 = /256

#-----------------------------------------------------------------------------
# Debug and Diagnostics
#-----------------------------------------------------------------------------

menu "SPI Debug Options"

config STM32_SPI_DEBUG
    bool "Enable SPI debug output"
    default n
    help
      Enable debug output for SPI driver.
      Useful for troubleshooting but increases code size.

config STM32_SPI_STATS_EXTENDED
    bool "Enable extended statistics"
    default n
    help
      Track additional metrics:
      - Transfer count
      - Error count
      - Average transfer size
      Increases memory usage slightly.

config STM32_SPI_TEST_SUPPORT
    bool "Enable test support functions"
    default n
    help
      Enable test helper functions for unit testing.
      Should be disabled in production builds.

endmenu

#-----------------------------------------------------------------------------
# SPI Instance Configuration
#-----------------------------------------------------------------------------

menuconfig STM32_SPI0_ENABLE
    bool "Enable SPI0"
    default n
    help
      Enable SPI0 instance.

if STM32_SPI0_ENABLE

config STM32_SPI0_USE_OSAL
    bool "SPI0 use OSAL"
    default STM32_SPI_USE_OSAL
    depends on STM32_SPI_USE_OSAL

config STM32_SPI0_USE_DMA
    bool "SPI0 use DMA"
    default STM32_SPI_USE_DMA
    depends on STM32_SPI_USE_DMA

endif # STM32_SPI0_ENABLE

menuconfig STM32_SPI1_ENABLE
    bool "Enable SPI1"
    default n
    help
      Enable SPI1 instance.

if STM32_SPI1_ENABLE

config STM32_SPI1_USE_OSAL
    bool "SPI1 use OSAL"
    default STM32_SPI_USE_OSAL
    depends on STM32_SPI_USE_OSAL

config STM32_SPI1_USE_DMA
    bool "SPI1 use DMA"
    default STM32_SPI_USE_DMA
    depends on STM32_SPI_USE_DMA

endif # STM32_SPI1_ENABLE

menuconfig STM32_SPI2_ENABLE
    bool "Enable SPI2"
    default n
    help
      Enable SPI2 instance.

if STM32_SPI2_ENABLE

config STM32_SPI2_USE_OSAL
    bool "SPI2 use OSAL"
    default STM32_SPI_USE_OSAL
    depends on STM32_SPI_USE_OSAL

config STM32_SPI2_USE_DMA
    bool "SPI2 use DMA"
    default STM32_SPI_USE_DMA
    depends on STM32_SPI_USE_DMA

endif # STM32_SPI2_ENABLE

menuconfig STM32_SPI3_ENABLE
    bool "Enable SPI3"
    default n
    help
      Enable SPI3 instance.

if STM32_SPI3_ENABLE

config STM32_SPI3_USE_OSAL
    bool "SPI3 use OSAL"
    default STM32_SPI_USE_OSAL
    depends on STM32_SPI_USE_OSAL

config STM32_SPI3_USE_DMA
    bool "SPI3 use DMA"
    default STM32_SPI_USE_DMA
    depends on STM32_SPI_USE_DMA

endif # STM32_SPI3_ENABLE

menuconfig STM32_SPI4_ENABLE
    bool "Enable SPI4"
    default n
    help
      Enable SPI4 instance.

if STM32_SPI4_ENABLE

config STM32_SPI4_USE_OSAL
    bool "SPI4 use OSAL"
    default STM32_SPI_USE_OSAL
    depends on STM32_SPI_USE_OSAL

config STM32_SPI4_USE_DMA
    bool "SPI4 use DMA"
    default STM32_SPI_USE_DMA
    depends on STM32_SPI_USE_DMA

endif # STM32_SPI4_ENABLE

menuconfig STM32_SPI5_ENABLE
    bool "Enable SPI5"
    default n
    help
      Enable SPI5 instance.

if STM32_SPI5_ENABLE

config STM32_SPI5_USE_OSAL
    bool "SPI5 use OSAL"
    default STM32_SPI_USE_OSAL
    depends on STM32_SPI_USE_OSAL

config STM32_SPI5_USE_DMA
    bool "SPI5 use DMA"
    default STM32_SPI_USE_DMA
    depends on STM32_SPI_USE_DMA

endif # STM32_SPI5_ENABLE
```

## platforms/stm32/src/hal/uart/Kconfig
```kconfig
#STM32 UART Driver Configuration
#This file is sourced from platforms / stm32 / src / hal / Kconfig
#when STM32_UART_ENABLE is selected

config STM32_UART_MAX_INSTANCES
    int "Maximum number of UART instances"
    default 6
    range 1 8
    help
      Maximum number of UART instances supported by the platform.
      This determines the size of the UART instance array.

config STM32_UART_USE_OSAL
    bool "Use OSAL for thread safety"
    default n
    depends on OSAL_ENABLE
    help
      Enable OSAL integration for UART driver.
      When enabled, UART operations are protected by mutexes
      and DMA transfers use semaphores for synchronization.

      This is required for multi-threaded applications using RTOS.
      For bare-metal applications, this can be disabled.

config STM32_UART_USE_DMA
    bool "Enable DMA support for UART"
    default n
    help
      Enable DMA (Direct Memory Access) support for UART transfers.
      DMA can significantly reduce CPU load for large data transfers.

      Note: DMA support requires proper DMA channel configuration
      and may require OSAL for synchronization.

config STM32_UART_DEFAULT_BAUDRATE
    int "Default UART baud rate"
    default 115200
    help
      Default baud rate for UART communication.
      Common values: 9600, 19200, 38400, 57600, 115200, 230400, 460800

config STM32_UART_DEFAULT_WORD_LENGTH
    int "Default word length"
    default 0
    help
      Default word length (data bits) for UART.
      0 = 8 bits (UART_WORDLENGTH_8B)
      1 = 9 bits (UART_WORDLENGTH_9B)

config STM32_UART_DEFAULT_STOP_BITS
    int "Default stop bits"
    default 0
    help
      Default stop bits for UART.
      0 = 1 stop bit (UART_STOPBITS_1)
      1 = 2 stop bits (UART_STOPBITS_2)

config STM32_UART_DEFAULT_PARITY
    int "Default parity"
    default 0
    help
      Default parity setting for UART.
      0 = No parity (UART_PARITY_NONE)
      1 = Even parity (UART_PARITY_EVEN)
      2 = Odd parity (UART_PARITY_ODD)

#-- -- -- -- -- -- -- -- -- -- -- -- -- -- -- -- -- -- -- -- -- -- -- -- -- -- -- -- -- -- -- -- -- -- -- -- -- -- -
#Buffer Configuration
#-- -- -- -- -- -- -- -- -- -- -- -- -- -- -- -- -- -- -- -- -- -- -- -- -- -- -- -- -- -- -- -- -- -- -- -- -- -- -

menu "UART Buffer Configuration"

config STM32_UART_DEFAULT_TX_BUFFER_SIZE
    int "Default TX buffer size (bytes)"
    default 256
    range 0 4096
    help
      Default size of TX circular buffer in bytes.
      Set to 0 to disable buffering (direct HAL transmission).
      Larger buffers improve throughput but consume more RAM.

config STM32_UART_DEFAULT_RX_BUFFER_SIZE
    int "Default RX buffer size (bytes)"
    default 256
    range 0 4096
    help
      Default size of RX circular buffer in bytes.
      Set to 0 to disable buffering (direct HAL reception).
      Larger buffers reduce data loss risk but consume more RAM.

config STM32_UART_BUFFER_OVERFLOW_POLICY
    int "Buffer overflow policy"
    default 1
    range 0 2
    help
      Policy when buffer is full:
      0 = Drop old data (overwrite)
      1 = Drop new data (reject)
      2 = Return error and let user handle

config STM32_UART_ENABLE_WATERMARK
    bool "Enable buffer watermark"
    default n
    help
      Enable high/low watermark for buffer management.
      Useful for flow control and monitoring buffer usage.

if STM32_UART_ENABLE_WATERMARK

config STM32_UART_HIGH_WATERMARK_PERCENT
    int "High watermark percentage"
    default 75
    range 50 95
    help
      High watermark as percentage of buffer size.
      When buffer usage exceeds this, high watermark flag is set.

config STM32_UART_LOW_WATERMARK_PERCENT
    int "Low watermark percentage"
    default 25
    range 5 50
    help
      Low watermark as percentage of buffer size.
      When buffer usage falls below this, low watermark flag is set.

endif # STM32_UART_ENABLE_WATERMARK

endmenu

#-- -- -- -- -- -- -- -- -- -- -- -- -- -- -- -- -- -- -- -- -- -- -- -- -- -- -- -- -- -- -- -- -- -- -- -- -- -- -
#Debug and Diagnostics
#-- -- -- -- -- -- -- -- -- -- -- -- -- -- -- -- -- -- -- -- -- -- -- -- -- -- -- -- -- -- -- -- -- -- -- -- -- -- -

menu "UART Debug Options"

config STM32_UART_DEBUG
    bool "Enable UART debug output"
    default n
    help
      Enable debug output for UART driver.
      Useful for troubleshooting but increases code size.

config STM32_UART_STATS_EXTENDED
    bool "Enable extended statistics"
    default n
    help
      Track additional metrics:
      - Peak buffer usage
      - Overflow count
      - Average transfer size
      Increases memory usage slightly.

config STM32_UART_TEST_SUPPORT
    bool "Enable test support functions"
    default n
    help
      Enable test helper functions for unit testing.
      Should be disabled in production builds.

endmenu

#-- -- -- -- -- -- -- -- -- -- -- -- -- -- -- -- -- -- -- -- -- -- -- -- -- -- -- -- -- -- -- -- -- -- -- -- -- -- -
#UART Instance Configuration
#-- -- -- -- -- -- -- -- -- -- -- -- -- -- -- -- -- -- -- -- -- -- -- -- -- -- -- -- -- -- -- -- -- -- -- -- -- -- -

menuconfig INSTANCE_STM32_UART_0
    bool "Enable UART0"
    default y
    help
      Enable UART0 instance.

if INSTANCE_STM32_UART_0

config STM32_UART0_BAUDRATE
    int "UART0 baud rate"
    default STM32_UART_DEFAULT_BAUDRATE

config STM32_UART0_TX_BUFFER_SIZE
    int "UART0 TX buffer size"
    default STM32_UART_DEFAULT_TX_BUFFER_SIZE
    range 0 4096

config STM32_UART0_RX_BUFFER_SIZE
    int "UART0 RX buffer size"
    default STM32_UART_DEFAULT_RX_BUFFER_SIZE
    range 0 4096

config STM32_UART0_USE_OSAL
    bool "UART0 use OSAL"
    default STM32_UART_USE_OSAL
    depends on STM32_UART_USE_OSAL

config STM32_UART0_USE_DMA
    bool "UART0 use DMA"
    default STM32_UART_USE_DMA
    depends on STM32_UART_USE_DMA

endif # INSTANCE_STM32_UART_0

menuconfig INSTANCE_STM32_UART_1
    bool "Enable UART1"
    default n
    help
      Enable UART1 instance.

if INSTANCE_STM32_UART_1

config STM32_UART1_BAUDRATE
    int "UART1 baud rate"
    default STM32_UART_DEFAULT_BAUDRATE

config STM32_UART1_TX_BUFFER_SIZE
    int "UART1 TX buffer size"
    default STM32_UART_DEFAULT_TX_BUFFER_SIZE
    range 0 4096

config STM32_UART1_RX_BUFFER_SIZE
    int "UART1 RX buffer size"
    default STM32_UART_DEFAULT_RX_BUFFER_SIZE
    range 0 4096

config STM32_UART1_USE_OSAL
    bool "UART1 use OSAL"
    default STM32_UART_USE_OSAL
    depends on STM32_UART_USE_OSAL

config STM32_UART1_USE_DMA
    bool "UART1 use DMA"
    default STM32_UART_USE_DMA
    depends on STM32_UART_USE_DMA

endif # INSTANCE_STM32_UART_1

menuconfig INSTANCE_STM32_UART_2
    bool "Enable UART2"
    default n
    help
      Enable UART2 instance.

if INSTANCE_STM32_UART_2

config STM32_UART2_BAUDRATE
    int "UART2 baud rate"
    default STM32_UART_DEFAULT_BAUDRATE

config STM32_UART2_TX_BUFFER_SIZE
    int "UART2 TX buffer size"
    default STM32_UART_DEFAULT_TX_BUFFER_SIZE
    range 0 4096

config STM32_UART2_RX_BUFFER_SIZE
    int "UART2 RX buffer size"
    default STM32_UART_DEFAULT_RX_BUFFER_SIZE
    range 0 4096

config STM32_UART2_USE_OSAL
    bool "UART2 use OSAL"
    default STM32_UART_USE_OSAL
    depends on STM32_UART_USE_OSAL

config STM32_UART2_USE_DMA
    bool "UART2 use DMA"
    default STM32_UART_USE_DMA
    depends on STM32_UART_USE_DMA

endif # INSTANCE_STM32_UART_2
```

## platforms/stm32/src/interrupt/Kconfig
```kconfig
menu "Interrupt Configuration"

config STM32_NVIC_PRIORITY_GROUP
    int "NVIC priority grouping"
    default 4
    range 0 4
    help
      NVIC priority grouping configuration.
      Determines how interrupt priority bits are split between
      preemption priority and sub-priority.

      Values:
        0 = NVIC_PRIORITYGROUP_0 (0 bits preemption, 4 bits sub-priority)
        1 = NVIC_PRIORITYGROUP_1 (1 bit preemption, 3 bits sub-priority)
        2 = NVIC_PRIORITYGROUP_2 (2 bits preemption, 2 bits sub-priority)
        3 = NVIC_PRIORITYGROUP_3 (3 bits preemption, 1 bit sub-priority)
        4 = NVIC_PRIORITYGROUP_4 (4 bits preemption, 0 bits sub-priority)

      Recommended: 4 (all bits for preemption priority)

config STM32_SYSTICK_PRIORITY
    int "SysTick interrupt priority"
    default 15
    range 0 15
    help
      SysTick timer interrupt priority (0-15).
      Lower values = higher priority.

      Recommended: 15 (lowest priority) to allow other interrupts
      to preempt SysTick.

config STM32_PENDSV_PRIORITY
    int "PendSV interrupt priority"
    default 15
    range 0 15
    help
      PendSV interrupt priority (0-15).
      Lower values = higher priority.

      Recommended: 15 (lowest priority) for RTOS context switching.

endmenu
```
