## platforms/stm32/src/system/Kconfig
```kconfig
menu "System Configuration"

config STM32_VDD_VALUE
    int "VDD voltage (mV)"
    default 3300
    range 1800 3600
    help
      Supply voltage in millivolts.
      Typical values: 3300 (3.3V), 1800 (1.8V)

config STM32_TICK_INT_PRIORITY
    hex "SysTick interrupt priority"
    default 0x0F
    range 0x00 0x0F
    help
      Priority for SysTick timer interrupt.
      Lower values = higher priority.
      Default 0x0F is lowest priority.

config STM32_USE_RTOS
    bool "Use RTOS"
    default n
    help
      Enable RTOS support in HAL driver.
      Affects timeout and delay implementations.

config STM32_PREFETCH_ENABLE
    bool "Enable instruction prefetch"
    default y
    help
      Enable instruction prefetch buffer.
      Improves performance for code in Flash.

config STM32_INSTRUCTION_CACHE_ENABLE
    bool "Enable instruction cache"
    default y
    depends on STM32F4 || STM32F7 || STM32H7
    help
      Enable instruction cache (I-Cache).
      Significantly improves performance.
      Available on STM32F4, STM32F7, and STM32H7 series.

config STM32_DATA_CACHE_ENABLE
    bool "Enable data cache"
    default y
    depends on STM32F4 || STM32F7 || STM32H7
    help
      Enable data cache (D-Cache).
      Improves data access performance.
      Available on STM32F4, STM32F7, and STM32H7 series.

config STM32_USE_FULL_ASSERT
    bool "Enable full assert"
    default y if DEBUG
    default n
    help
      Enable assert_param macro in HAL drivers.
      Useful for debugging but increases code size.
      Automatically enabled in DEBUG builds.

config STM32_ENABLE_PERFORMANCE_MEASUREMENT
    bool "Enable performance measurement"
    default y
    help
      Enable DWT-based performance measurement features.
      Provides boot time measurement, code size analysis,
      and function profiling capabilities.
      Minimal overhead when not actively profiling.

config STM32_BOOT_TIME_MEASUREMENT
    bool "Enable boot time measurement"
    default y
    depends on STM32_ENABLE_PERFORMANCE_MEASUREMENT
    help
      Automatically measure boot time from reset to platform_init.
      Results can be retrieved via stm32_boot_time_get() or
      printed via stm32_boot_time_report().
      Target: < 10ms total boot time.

config STM32_CODE_SIZE_REPORTING
    bool "Enable code size reporting"
    default y
    depends on STM32_ENABLE_PERFORMANCE_MEASUREMENT
    help
      Enable code size measurement and reporting.
      Calculates Flash and RAM usage from linker symbols.
      Target: < 10KB for core functionality.

config STM32_ENABLE_PROFILING
    bool "Enable advanced profiling"
    default n
    depends on STM32_ENABLE_PERFORMANCE_MEASUREMENT
    help
      Enable advanced profiling features for hot path analysis.
      Provides zone-based profiling with detailed statistics.
      Use STM32_PROFILE_ZONE() and STM32_PROFILE_FUNCTION() macros.
      Minimal overhead when zones are not active.

config STM32_PROFILER_MAX_ZONES
    int "Maximum profiling zones"
    default 32
    range 8 128
    depends on STM32_ENABLE_PROFILING
    help
      Maximum number of profiling zones that can be tracked.
      Each zone uses approximately 32 bytes of RAM.
      Increase if you see overflow warnings.

endmenu
```

## products/Kconfig
```kconfig
menu "Product assembly"

choice
    prompt "Product profile"
    default PRODUCT_NATIVE_REFERENCE if BOARD_NATIVE_REFERENCE
    default PRODUCT_STM32F407_DISCOVERY if BOARD_STM32F4DISCOVERY
    default PRODUCT_GD32F470_LIANGSHAN if BOARD_GD32F470_LIANGSHAN
    default PRODUCT_QIMING_STM32F407ZG_V31 if BOARD_STM32F407_QIMING_V31
    default PRODUCT_SKY_STM32F407VE_QINGCHUN if BOARD_STM32F407VE_SKY_QINGCHUN

config PRODUCT_NATIVE_REFERENCE
    bool "Native reference product"
    depends on BOARD_NATIVE_REFERENCE

config PRODUCT_STM32F407_DISCOVERY
    bool "STM32F407VG Discovery reference product"
    depends on BOARD_STM32F4DISCOVERY

config PRODUCT_GD32F470_LIANGSHAN
    bool "GD32F470ZG Liangshan reference product"
    depends on BOARD_GD32F470_LIANGSHAN
config PRODUCT_QIMING_STM32F407ZG_V31
    bool "Qiming STM32F407ZGT6 V3.1 reference product"
    depends on BOARD_STM32F407_QIMING_V31
config PRODUCT_SKY_STM32F407VE_QINGCHUN
    bool "Sky STM32F407VET6 youth reference product"
    depends on BOARD_STM32F407VE_SKY_QINGCHUN
endchoice

config PRODUCT_NAME
    string
    default "native-reference" if PRODUCT_NATIVE_REFERENCE
    default "stm32f407-discovery" if PRODUCT_STM32F407_DISCOVERY
    default "gd32f470-liangshan" if PRODUCT_GD32F470_LIANGSHAN
    default "stm32f407zg-qiming-v31" if PRODUCT_QIMING_STM32F407ZG_V31
    default "stm32f407ve-sky-qingchun" if PRODUCT_SKY_STM32F407VE_QINGCHUN

endmenu
```

## services/Kconfig
```kconfig
menu "Optional common components"

config SERVICE_STORAGE
    bool "Atomic storage service"
    default y
    help
      Build the storage port and recoverable two-bank snapshot implementation.
      Physical SoC Flash providers remain independent of storage policy.

config SERVICE_SECURITY
    bool "Cryptographic provider service"
    default y
    help
      The core does not bind a default provider. Select the explicit Native
      OpenSSL adapter or supply a maintained provider; unsupported operations
      fail explicitly.

config SERVICE_UPDATE
    bool "Authenticated update policy"
    default y
    help
      Policy and recovery state only; the product supplies its image installer,
      boot selection, protected counters and trust boundary.

config SERVICE_PROTOCOLS
    bool "Modbus RTU protocol"
    default y

config SERVICE_INDUSTRIAL
    bool "Industrial health supervision"
    default y

endmenu

source "services/security/Kconfig"
```

## services/security/Kconfig
```kconfig
config CRYPTO_PROVIDER_OPENSSL
    bool "OpenSSL 3 crypto provider"
    depends on SERVICE_SECURITY && PLATFORM_NATIVE
    default n
    help
      Build the explicitly selected Native OpenSSL 3 provider target. Building
      this target does not activate cryptography: external startup must bind
      its provider with nx_crypto_set_provider(). MCU providers are external.
```

## soc/gd32f470/Kconfig
```kconfig
# Maintained F470ZG silicon and controller declarations.
config GD32F470ZG
    bool
    default y

config GD32_SYSCLK_FREQ
    int
    default 200000000

config GD32_HXTAL_VALUE
    int
    default 25000000

config GD32_RS485_ENABLE
    bool "External RS485 transceiver on PB1 DE (product wiring required)"
    default n

config GD32_GPIO_ENABLE
    bool "Reference board status GPIO"
    default y

config GD32_UART_ENABLE
    bool "USART0 interrupt driver"
    default y

config GD32_UART0_ENABLE
    bool
    default y if GD32_UART_ENABLE

config GD32_UART0_BAUDRATE
    int "USART0 baud rate"
    range 1200 115200
    default 115200

config GD32_UART_RX_BUFFER_SIZE
    int "USART0 timestamped RX event capacity"
    range 16 512
    default 128

config GD32_SPI_ENABLE
    bool "SPI4 polling transaction driver"
    default y

config GD32_SPI4_ENABLE
    bool
    default y if GD32_SPI_ENABLE

config GD32_SPI_DEVICE_CAPACITY
    int "SPI4 bounded device slots"
    range 1 8
    default 4

# Physical contiguous main SRAM; ADDRAM/TCM are separate memory domains.
config LINKER_RAM_START
    hex
    default 0x20000000
config LINKER_RAM_SIZE
    hex
    default 0x30000
config LINKER_FLASH_START
    hex
    default 0x08000000
config LINKER_FLASH_SIZE
    hex
    default 0x100000
```

## soc/native/Kconfig
```kconfig
# Virtual host resource models; these do not advertise physical MCU capabilities.
menu "Native Host Models"
rsource "controllers/uart/Kconfig"
rsource "controllers/gpio/Kconfig"
rsource "controllers/spi/Kconfig"
rsource "controllers/i2c/Kconfig"
rsource "controllers/timer/Kconfig"
rsource "controllers/adc/Kconfig"
rsource "controllers/dac/Kconfig"
rsource "controllers/crc/Kconfig"
rsource "controllers/usb/Kconfig"
rsource "controllers/flash/Kconfig"
rsource "controllers/rtc/Kconfig"
rsource "controllers/watchdog/Kconfig"
rsource "controllers/sdio/Kconfig"
rsource "controllers/option_bytes/Kconfig"
endmenu
```

## soc/stm32f407/chips/Kconfig
```kconfig
# The implementation is STM32F407; other STM32 families are not selectable.
config STM32F4
    bool
    default y

config STM32F407
    bool
    default y

config STM32_SERIES
    string
    default "stm32f4"

config STM32_CHIP_NAME
    string
    default "STM32F407xx"

config STM32_HAS_FPU
    bool
    default y

config STM32_HAS_MPU
    bool
    default y
    help
      Silicon feature only. Nexus does not currently configure MPU regions.

config STM32_HAS_ICACHE
    bool
    default n
    help
      The Cortex-M4 has no CPU I-cache. Flash acceleration is separate.

config STM32_HAS_DCACHE
    bool
    default n
    help
      The Cortex-M4 has no CPU D-cache. Flash acceleration is separate.

config STM32_HAS_TRUSTZONE
    bool
    default n

choice
    prompt "STM32F407 part"
    default STM32F407VG

config STM32F407VG
    bool "STM32F407VGT6 (1 MiB Flash, LQFP100)"
config STM32F407ZG
    bool "STM32F407ZGT6 (1 MiB Flash, LQFP144)"
config STM32F407VE
    bool "STM32F407VET6 (512 KiB Flash, LQFP100)"

endchoice

config STM32_PART_NAME
    string
    default "STM32F407VGT6" if STM32F407VG
    default "STM32F407ZGT6" if STM32F407ZG
    default "STM32F407VET6" if STM32F407VE

config STM32_FLASH_SIZE
    hex
    default 0x80000 if STM32F407VE
    default 0x100000

config STM32_SRAM_SIZE
    hex
    default 0x30000
    help
      Total physical SRAM: 128 KiB main SRAM and 64 KiB non-DMA CCM.
      The maintained linker uses main SRAM; it does not allocate CCM.

# Physical main-memory identity consumed by the external linker-layout parser.
config LINKER_RAM_START
    hex
    default 0x20000000
config LINKER_RAM_SIZE
    hex
    default 0x20000
config LINKER_FLASH_START
    hex
    default 0x08000000
config LINKER_FLASH_SIZE
    hex
    default STM32_FLASH_SIZE
```

## soc/stm32f407/clock/Kconfig
```kconfig
menu "STM32F407 Clock"

config STM32_HSE_ENABLE
    bool "Use board HSE crystal as PLL input"
    default y
    help
      Clock initialization fails if the selected oscillator cannot start.
      Disabling this selects the fixed 16 MHz HSI input.

config STM32_HSE_VALUE
    int "Board HSE frequency (Hz)"
    default 8000000
    range 4000000 26000000
    help
      Must match the selected Board package, even when HSI is selected.

config STM32_HSE_STARTUP_TIMEOUT
    int "Vendor HSE startup timeout (ms)"
    default 100
    range 10 1000

config STM32_HSI_VALUE
    int
    default 16000000

config STM32_SYSCLK_FREQ
    int "Target system clock frequency (Hz)"
    default 168000000
    range 24000000 168000000
    help
      The F407 PLL calculation and initialization validate this request.
      The target cannot exceed the silicon maximum of 168 MHz.

endmenu
```

## soc/stm32f407/controllers/Kconfig
```kconfig
menu "STM32F407 Controllers"

menuconfig STM32_GPIO_ENABLE
    bool "GPIO provider"
    default y
if STM32_GPIO_ENABLE
rsource "gpio/Kconfig"
endif

menuconfig STM32_UART_ENABLE
    bool "Interrupt-driven UART provider"
    default y
    help
      Maintained TX completion, RX event ring and finite ownership contracts.
      UART DMA is unavailable and explicit DMA requests are rejected.
if STM32_UART_ENABLE
rsource "uart/Kconfig"
endif

menuconfig STM32_SPI_ENABLE
    bool "SPI transaction provider"
    default n
    help
      Polling transactions and optional Board-bound SPI DMA.
      Each enabled physical bus requires a reviewed Board binding.
if STM32_SPI_ENABLE
rsource "spi/Kconfig"
endif

endmenu

# Vendor dependencies are implementation details, not peripheral capabilities.
config HAL_GPIO_MODULE
    bool
    default y
config HAL_RCC_MODULE
    bool
    default y
config HAL_CORTEX_MODULE
    bool
    default y
config HAL_FLASH_MODULE
    bool
    default y
config HAL_PWR_MODULE
    bool
    default y
config HAL_UART_MODULE
    bool
    default y if STM32_UART_ENABLE
config HAL_SPI_MODULE
    bool
    default y if STM32_SPI_ENABLE
config HAL_DMA_MODULE
    bool
    default y if STM32_UART_ENABLE || STM32_SPI_ENABLE
    help
      The vendor UART/SPI modules depend on HAL DMA functions and types.
      This does not advertise Nexus UART DMA support.
```

## soc/stm32f407/controllers/spi/Kconfig
```kconfig
# STM32F407 implements physical SPI1..SPI3. Board bindings must exist for a bus.
config STM32_SPI_USE_OSAL
    bool "Serialize SPI transactions with OSAL"
    default y if OSAL_FREERTOS
    depends on OSAL_FREERTOS
config STM32_SPI_USE_DMA
    bool "Enable SPI DMA (requires board channels and interrupt wiring)"
    default n
config STM32_SPI1_ENABLE
    bool "Enable physical SPI1"
    default n
config STM32_SPI2_ENABLE
    bool "Enable physical SPI2"
    default n
config STM32_SPI3_ENABLE
    bool "Enable physical SPI3"
    default n
```
