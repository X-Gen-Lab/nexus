## platforms/stm32/src/clock/Kconfig
```kconfig
# Clock Configuration
# This file configures the system clock and oscillator settings for STM32 platform

menu "Clock Configuration"

config STM32_HSE_ENABLE
    bool "Enable HSE (External High Speed oscillator)"
    default y
    help
      Enable the external high-speed oscillator.
      Required for most applications using external crystal.
      If HSE fails to start, the system will automatically fall back to HSI.

config STM32_HSE_VALUE
    int "HSE frequency (Hz)"
    default 8000000 if STM32F0 || STM32F1 || STM32F4
    default 25000000 if STM32H7
    default 8000000
    range 4000000 50000000
    depends on STM32_HSE_ENABLE
    help
      Frequency of the external high-speed oscillator in Hz.
      Common values:
        - STM32F0/F1/F4: 8MHz, 12MHz, 16MHz
        - STM32H7: 25MHz

      This value must match your hardware crystal frequency.

config STM32_HSE_STARTUP_TIMEOUT
    int "HSE startup timeout (ms)"
    default 100
    range 10 1000
    depends on STM32_HSE_ENABLE
    help
      Timeout value for HSE oscillator startup in milliseconds.
      Typical value is 100ms. If HSE fails to start within this
      timeout, the system will fall back to HSI.

config STM32_HSI_VALUE
    int "HSI frequency (Hz)"
    default 8000000 if STM32F0 || STM32F1
    default 16000000 if STM32F4
    default 64000000 if STM32H7
    default 16000000 if STM32L4
    default 16000000
    help
      Internal high-speed oscillator frequency.
      This is fixed by hardware:
        - STM32F0/F1: 8MHz
        - STM32F2/F3/F4/F7: 16MHz
        - STM32H7: 64MHz
        - STM32L4: 16MHz

      This value is used as fallback when HSE fails.

config STM32_MSI_ENABLE
    bool "Enable MSI (Multi-Speed Internal oscillator)"
    default n
    depends on STM32L4
    help
      Enable the multi-speed internal oscillator (MSI).
      MSI is available on STM32L4 series and provides
      multiple frequency ranges from 100kHz to 48MHz.
      MSI can be used as system clock or PLL source.

config STM32_MSI_VALUE
    int "MSI frequency (Hz)"
    default 4000000
    range 100000 48000000
    depends on STM32_MSI_ENABLE
    help
      Multi-speed internal oscillator frequency.
      Available ranges for STM32L4:
        - Range 0: ~100 kHz
        - Range 1: ~200 kHz
        - Range 2: ~400 kHz
        - Range 3: ~800 kHz
        - Range 4: ~1 MHz
        - Range 5: ~2 MHz
        - Range 6: ~4 MHz (default after reset)
        - Range 7: ~8 MHz
        - Range 8: ~16 MHz
        - Range 9: ~24 MHz
        - Range 10: ~32 MHz
        - Range 11: ~48 MHz

      Default is 4MHz (Range 6).

config STM32_SYSCLK_FREQ
    int "Target system clock frequency (Hz)"
    default 48000000 if STM32F0
    default 72000000 if STM32F1
    default 168000000 if STM32F407xx
    default 180000000 if STM32F429xx || STM32F446xx
    default 480000000 if STM32H7
    default 80000000 if STM32L4
    default 168000000
    help
      Target system clock frequency in Hz.
      The PLL parameters will be automatically calculated to achieve
      this frequency from the selected clock source (HSE or HSI).

      Maximum frequencies:
        - STM32F0: 48MHz
        - STM32F1: 72MHz
        - STM32F407: 168MHz
        - STM32F429/F446: 180MHz (with Over-Drive mode)
        - STM32H7: 480MHz
        - STM32L4: 80MHz

      Note: Actual frequency may differ slightly due to PLL limitations.

config STM32_LSE_ENABLE
    bool "Enable LSE (External Low Speed oscillator)"
    default n
    help
      Enable the external low-speed oscillator.
      Typically used for RTC with 32.768kHz crystal.

config STM32_LSE_VALUE
    int "LSE frequency (Hz)"
    default 32768
    depends on STM32_LSE_ENABLE
    help
      Frequency of the external low-speed oscillator in Hz.
      Standard value is 32768 Hz (32.768 kHz) for RTC applications.

config STM32_LSE_STARTUP_TIMEOUT
    int "LSE startup timeout (ms)"
    default 5000
    range 1000 10000
    depends on STM32_LSE_ENABLE
    help
      Timeout value for LSE oscillator startup in milliseconds.
      LSE startup is slower than HSE, typical value is 5000ms.

config STM32_LSI_VALUE
    int "LSI frequency (Hz)"
    default 32000
    help
      Internal low-speed oscillator frequency.
      Approximate value, actual frequency varies (typically 32kHz).
      Used for watchdog and RTC when LSE is not available.

config STM32_EXTERNAL_CLOCK_VALUE
    int "External clock source for I2S (Hz)"
    default 12288000
    depends on STM32_HAL_I2S_MODULE
    help
      External clock source frequency for I2S peripheral in Hz.
      Common value is 12.288 MHz for audio applications.

endmenu
```

## platforms/stm32/src/hal/Kconfig
```kconfig
#-----------------------------------------------------------------------------
# STM32 HAL Driver Configuration
#-----------------------------------------------------------------------------
# HAL (Hardware Abstraction Layer) drivers implement Nexus peripheral
# interfaces using STM32 HAL library as the underlying implementation.
#
# Architecture:
#   - Each HAL driver is a thin wrapper around STM32 HAL
#   - Maximum reuse of STM32 HAL capabilities
#   - Minimal code (<2000 lines per driver)
#   - Zero-copy data paths where possible
#
# Directory structure:
#   hal/uart/    - UART driver + Kconfig
#   hal/spi/     - SPI driver + Kconfig
#   hal/i2c/     - I2C driver + Kconfig
#   hal/timer/   - Timer driver + Kconfig
#   ...
#-----------------------------------------------------------------------------

menu "HAL Drivers"

#-----------------------------------------------------------------------------
# UART Driver
#-----------------------------------------------------------------------------

menuconfig STM32_UART_ENABLE
    bool "Enable UART driver"
    default y
    select HAL_UART_MODULE
    select HAL_USART_MODULE
    select HAL_GPIO_MODULE
    select HAL_RCC_MODULE
    select HAL_CORTEX_MODULE
    help
      Enable UART (Universal Asynchronous Receiver/Transmitter) driver.

      This driver implements Nexus HAL UART interface using STM32 HAL
      as the underlying implementation. It provides:
        - Synchronous and asynchronous TX/RX
        - DMA support for high-throughput transfers
        - Circular buffer management
        - Error handling and statistics
        - Multi-instance support

      Code size: ~1800 lines
      Architecture: Thin wrapper, maximum STM32 HAL reuse

if STM32_UART_ENABLE
source "platforms/stm32/src/hal/uart/Kconfig"
endif

#-----------------------------------------------------------------------------
# GPIO Driver
#-----------------------------------------------------------------------------

menuconfig STM32_GPIO_ENABLE
    bool "Enable GPIO driver"
    default y
    select HAL_GPIO_MODULE
    select HAL_RCC_MODULE
    help
      Enable GPIO (General Purpose Input/Output) driver.

      This driver implements Nexus HAL GPIO interface using STM32 HAL
      as the underlying implementation. It provides:
        - Digital input/output operations
        - Pin read/write/toggle
        - Configurable mode, pull, and speed
        - Lifecycle management
        - Power management support

      Code size: ~500 lines
      Architecture: Thin wrapper, maximum STM32 HAL reuse

if STM32_GPIO_ENABLE
source "platforms/stm32/src/hal/gpio/Kconfig"
endif

#-----------------------------------------------------------------------------
# SPI Driver
#-----------------------------------------------------------------------------

menuconfig STM32_SPI_ENABLE
    bool "Enable SPI driver"
    default n
    select HAL_SPI_MODULE
    select HAL_GPIO_MODULE
    select HAL_RCC_MODULE
    help
      Enable SPI (Serial Peripheral Interface) driver.

      This driver implements Nexus HAL SPI interface using STM32 HAL
      as the underlying implementation. It provides:
        - Synchronous and asynchronous TX/RX
        - DMA support for high-throughput transfers
        - Multi-device support with Handle acquisition
        - Error handling and statistics
        - Multi-instance support

      Code size: ~1500 lines
      Architecture: Thin wrapper, maximum STM32 HAL reuse

if STM32_SPI_ENABLE
source "platforms/stm32/src/hal/spi/Kconfig"
endif

#-----------------------------------------------------------------------------
# I2C Driver (Future)
#-----------------------------------------------------------------------------

menuconfig STM32_I2C_ENABLE
    bool "Enable I2C driver"
    default n
    select HAL_I2C_MODULE
    select HAL_GPIO_MODULE
    select HAL_RCC_MODULE
    help
      Enable I2C (Inter-Integrated Circuit) driver.

      Status: Not yet implemented

#-----------------------------------------------------------------------------
# Timer Driver (Future)
#-----------------------------------------------------------------------------

menuconfig STM32_TIMER_ENABLE
    bool "Enable Timer driver"
    default n
    select HAL_TIM_MODULE
    select HAL_RCC_MODULE
    help
      Enable Timer driver for PWM, input capture, and timing.

      Status: Not yet implemented

#-----------------------------------------------------------------------------
# ADC Driver (Future)
#-----------------------------------------------------------------------------

menuconfig STM32_ADC_ENABLE
    bool "Enable ADC driver"
    default n
    select HAL_ADC_MODULE
    select HAL_GPIO_MODULE
    select HAL_RCC_MODULE
    help
      Enable ADC (Analog-to-Digital Converter) driver.

      Status: Not yet implemented

#-----------------------------------------------------------------------------
# DAC Driver (Future)
#-----------------------------------------------------------------------------

menuconfig STM32_DAC_ENABLE
    bool "Enable DAC driver"
    default n
    select HAL_DAC_MODULE
    select HAL_GPIO_MODULE
    select HAL_RCC_MODULE
    help
      Enable DAC (Digital-to-Analog Converter) driver.

      Status: Not yet implemented

endmenu  # HAL Drivers

#-----------------------------------------------------------------------------
# HAL Module Auto-Selection (Internal)
#-----------------------------------------------------------------------------
# These symbols are automatically selected by HAL drivers above.
# Users should not configure these directly.
#-----------------------------------------------------------------------------

menu "HAL Module Selection (Auto-configured)"
    visible if EXPERT_MODE

config HAL_UART_MODULE
    bool "HAL UART module"
    help
      STM32 HAL UART module support.
      Automatically selected when UART driver is enabled.

config HAL_USART_MODULE
    bool "HAL USART module"
    help
      STM32 HAL USART module support.
      Automatically selected when UART driver is enabled.

config HAL_SPI_MODULE
    bool "HAL SPI module"
    help
      STM32 HAL SPI module support.
      Automatically selected when SPI driver is enabled.

config HAL_I2C_MODULE
    bool "HAL I2C module"
    help
      STM32 HAL I2C module support.
      Automatically selected when I2C driver is enabled.

config HAL_TIM_MODULE
    bool "HAL Timer module"
    help
      STM32 HAL Timer module support.
      Automatically selected when Timer driver is enabled.

config HAL_ADC_MODULE
    bool "HAL ADC module"
    help
      STM32 HAL ADC module support.
      Automatically selected when ADC driver is enabled.

config HAL_DAC_MODULE
    bool "HAL DAC module"
    help
      STM32 HAL DAC module support.
      Automatically selected when DAC driver is enabled.

config HAL_DMA_MODULE
    bool "HAL DMA module"
    default y if STM32_UART_USE_DMA
    help
      STM32 HAL DMA module support.
      Automatically selected when DMA is used by any driver.

config HAL_GPIO_MODULE
    bool "HAL GPIO module"
    default y
    help
      STM32 HAL GPIO module support.
      Required by most peripheral drivers for pin configuration.

config HAL_RCC_MODULE
    bool "HAL RCC module"
    default y
    help
      STM32 HAL RCC (Reset and Clock Control) module support.
      Required for peripheral clock configuration.

config HAL_CORTEX_MODULE
    bool "HAL Cortex module"
    default y
    help
      STM32 HAL Cortex module support.
      Required for NVIC and SysTick configuration.

endmenu  # HAL Module Selection

#-----------------------------------------------------------------------------
# HAL Callback Configuration
#-----------------------------------------------------------------------------
# Configure which HAL callbacks are enabled.
# Disabling unused callbacks can reduce code size.
#-----------------------------------------------------------------------------

menu "HAL Callback Configuration"
    visible if EXPERT_MODE

config HAL_UART_TX_COMPLETE_CALLBACK
    bool "UART TX complete callback"
    default y if STM32_UART_ENABLE
    help
      Enable HAL_UART_TxCpltCallback support.
      Required for asynchronous UART transmission.

config HAL_UART_RX_COMPLETE_CALLBACK
    bool "UART RX complete callback"
    default y if STM32_UART_ENABLE
    help
      Enable HAL_UART_RxCpltCallback support.
      Required for asynchronous UART reception.

config HAL_UART_ERROR_CALLBACK
    bool "UART error callback"
    default y if STM32_UART_ENABLE
    help
      Enable HAL_UART_ErrorCallback support.
      Required for UART error handling.

endmenu  # HAL Callback Configuration
```
