## platforms/stm32/chips/Kconfig.stm32h7
```kconfig
#-----------------------------------------------------------------------------
# STM32H7 Series Chip Variant Selection
#-----------------------------------------------------------------------------
# STM32H7 series includes:
#   - STM32H743/753: Single-core, up to 480 MHz
#   - STM32H750: Value line with 128KB Flash
#   - STM32H7A3/7B3: Advanced line with graphics
#   - STM32H745/755: Dual-core (M7+M4)
#   - STM32H747/757: Dual-core with graphics
#-----------------------------------------------------------------------------

if STM32H7

choice
    prompt "STM32H7 Chip Variant"
    default STM32H743
    help
      Select specific STM32H7 chip variant.
      Different variants have different core configurations, memory sizes
      and peripheral features.

config STM32H743
    bool "STM32H743 (2MB Flash, 1MB SRAM, Single-core)"
    help
      STM32H743 variant:
      - Flash: 2 MB
      - SRAM: 1 MB
      - Core: Single Cortex-M7 @ 480 MHz
      - Features: High-speed USB, Ethernet, CAN FD
      - Package: LQFP100, LQFP144, LQFP176, TFBGA240

config STM32H750
    bool "STM32H750 (128KB Flash, 1MB SRAM, Value line)"
    help
      STM32H750 variant:
      - Flash: 128 KB (value line)
      - SRAM: 1 MB
      - Core: Single Cortex-M7 @ 480 MHz
      - Features: Optimized for external memory applications
      - Package: LQFP100, LQFP144, TFBGA240

config STM32H753
    bool "STM32H753 (2MB Flash, 1MB SRAM, Crypto)"
    help
      STM32H753 variant:
      - Flash: 2 MB
      - SRAM: 1 MB
      - Core: Single Cortex-M7 @ 480 MHz
      - Features: Crypto/hash accelerator, high-speed USB, Ethernet
      - Package: LQFP100, LQFP144, LQFP176, TFBGA240

config STM32H7A3
    bool "STM32H7A3 (2MB Flash, 1MB SRAM, Advanced)"
    help
      STM32H7A3 variant:
      - Flash: 2 MB
      - SRAM: 1 MB
      - Core: Single Cortex-M7 @ 280 MHz
      - Features: Advanced analog, SMPS, low power
      - Package: LQFP100, LQFP144, TFBGA100, TFBGA225

config STM32H7B3
    bool "STM32H7B3 (2MB Flash, 1MB SRAM, Graphics)"
    help
      STM32H7B3 variant:
      - Flash: 2 MB
      - SRAM: 1 MB
      - Core: Single Cortex-M7 @ 280 MHz
      - Features: LCD-TFT, JPEG codec, advanced analog
      - Package: LQFP100, LQFP144, TFBGA225

config STM32H745
    bool "STM32H745 (2MB Flash, 1MB SRAM, Dual-core)"
    help
      STM32H745 variant:
      - Flash: 2 MB
      - SRAM: 1 MB
      - Core: Dual-core Cortex-M7 @ 480 MHz + Cortex-M4 @ 240 MHz
      - Features: High-speed USB, Ethernet, CAN FD
      - Package: LQFP100, LQFP144, TFBGA240

config STM32H747
    bool "STM32H747 (2MB Flash, 1MB SRAM, Dual-core + Graphics)"
    help
      STM32H747 variant:
      - Flash: 2 MB
      - SRAM: 1 MB
      - Core: Dual-core Cortex-M7 @ 480 MHz + Cortex-M4 @ 240 MHz
      - Features: LCD-TFT, JPEG codec, USB, Ethernet
      - Package: LQFP100, LQFP144, TFBGA240

config STM32H755
    bool "STM32H755 (2MB Flash, 1MB SRAM, Dual-core + Crypto)"
    help
      STM32H755 variant:
      - Flash: 2 MB
      - SRAM: 1 MB
      - Core: Dual-core Cortex-M7 @ 480 MHz + Cortex-M4 @ 240 MHz
      - Features: Crypto/hash accelerator, USB, Ethernet
      - Package: LQFP100, LQFP144, TFBGA240

config STM32H757
    bool "STM32H757 (2MB Flash, 1MB SRAM, Dual-core + Graphics + Crypto)"
    help
      STM32H757 variant:
      - Flash: 2 MB
      - SRAM: 1 MB
      - Core: Dual-core Cortex-M7 @ 480 MHz + Cortex-M4 @ 240 MHz
      - Features: LCD-TFT, JPEG, crypto accelerator, USB, Ethernet
      - Package: LQFP100, LQFP144, TFBGA240

endchoice

#-----------------------------------------------------------------------------
# Chip Name Definition
#-----------------------------------------------------------------------------

config STM32_CHIP_NAME
    string
    default "STM32H743xx" if STM32H743
    default "STM32H750xx" if STM32H750
    default "STM32H753xx" if STM32H753
    default "STM32H7A3xx" if STM32H7A3
    default "STM32H7B3xx" if STM32H7B3
    default "STM32H745xx" if STM32H745
    default "STM32H747xx" if STM32H747
    default "STM32H755xx" if STM32H755
    default "STM32H757xx" if STM32H757
    help
      STM32 chip name for HAL driver selection and conditional compilation.

#-----------------------------------------------------------------------------
# Memory Configuration
#-----------------------------------------------------------------------------

config STM32_FLASH_SIZE
    hex "Flash size (bytes)"
    default 0x20000 if STM32H750
    default 0x200000 if STM32H743 || STM32H753 || STM32H7A3 || STM32H7B3 || STM32H745 || STM32H747 || STM32H755 || STM32H757
    help
      Flash memory size in bytes.

config STM32_SRAM_SIZE
    hex "SRAM size (bytes)"
    default 0x100000
    help
      Total SRAM memory size in bytes (1 MB).
      STM32H7 has multiple SRAM regions (DTCM, AXI SRAM, SRAM1-4).

#-----------------------------------------------------------------------------
# Core Configuration
#-----------------------------------------------------------------------------

config STM32H7_DUAL_CORE
    bool
    default y if STM32H745 || STM32H747 || STM32H755 || STM32H757
    help
      Whether the chip has dual-core architecture (M7+M4).

config STM32H7_M4_CORE_FREQ
    int
    default 240000000 if STM32H7_DUAL_CORE
    default 0
    help
      Cortex-M4 core frequency in Hz (for dual-core variants).

#-----------------------------------------------------------------------------
# Peripheral Feature Flags
#-----------------------------------------------------------------------------

config STM32H7_HAS_ETHERNET
    bool
    default y if STM32H743 || STM32H753 || STM32H745 || STM32H747 || STM32H755 || STM32H757
    help
      Whether the chip has Ethernet MAC peripheral.

config STM32H7_HAS_LTDC
    bool
    default y if STM32H7B3 || STM32H747 || STM32H757
    help
      Whether the chip has LCD-TFT display controller.

config STM32H7_HAS_JPEG
    bool
    default y if STM32H7B3 || STM32H747 || STM32H757
    help
      Whether the chip has JPEG codec.

config STM32H7_HAS_CRYPTO
    bool
    default y if STM32H753 || STM32H755 || STM32H757
    help
      Whether the chip has hardware crypto/hash accelerator.

config STM32H7_HAS_SMPS
    bool
    default y if STM32H7A3 || STM32H7B3
    help
      Whether the chip has integrated SMPS (Switched-Mode Power Supply).

endif # STM32H7
```

## platforms/stm32/chips/Kconfig.stm32l4
```kconfig
#-----------------------------------------------------------------------------
# STM32L4 Series Chip Variant Selection
#-----------------------------------------------------------------------------
# STM32L4 series includes:
#   - STM32L431/432/433: Compact, up to 80 MHz
#   - STM32L451/452/462: Mainstream, up to 80 MHz
#   - STM32L471/475/476: High performance, up to 80 MHz
#   - STM32L496/4A6: Advanced, up to 80 MHz
#   - STM32L4+: Enhanced performance, up to 120 MHz
#-----------------------------------------------------------------------------

if STM32L4

choice
    prompt "STM32L4 Chip Variant"
    default STM32L476
    help
      Select specific STM32L4 chip variant.
      Different variants have different memory sizes, peripheral
      configurations and ultra-low-power features.

config STM32L432
    bool "STM32L432 (256KB Flash, 64KB SRAM)"
    help
      STM32L432 variant:
      - Flash: 256 KB
      - SRAM: 64 KB
      - Frequency: 80 MHz
      - Features: USB, compact package
      - Package: LQFP32, LQFP48, UFQFPN32, UFQFPN48

config STM32L476
    bool "STM32L476 (1MB Flash, 128KB SRAM)"
    help
      STM32L476 variant:
      - Flash: 1 MB
      - SRAM: 128 KB
      - Frequency: 80 MHz
      - Features: USB OTG FS, LCD controller, DFSDM
      - Package: LQFP64, LQFP100, UFBGA132, WLCSP100

config STM32L496
    bool "STM32L496 (1MB Flash, 320KB SRAM)"
    help
      STM32L496 variant:
      - Flash: 1 MB
      - SRAM: 320 KB
      - Frequency: 80 MHz
      - Features: USB OTG FS, LCD, DFSDM, QSPI, AES
      - Package: LQFP100, LQFP144, UFBGA132, UFBGA169

config STM32L4R5
    bool "STM32L4R5 (2MB Flash, 640KB SRAM, L4+)"
    help
      STM32L4R5 variant (L4+ series):
      - Flash: 2 MB
      - SRAM: 640 KB
      - Frequency: 120 MHz
      - Features: Enhanced performance, USB OTG FS, OCTOSPI
      - Package: LQFP100, LQFP144, UFBGA132, UFBGA169

config STM32L4S5
    bool "STM32L4S5 (2MB Flash, 640KB SRAM, L4+ with AES)"
    help
      STM32L4S5 variant (L4+ series):
      - Flash: 2 MB
      - SRAM: 640 KB
      - Frequency: 120 MHz
      - Features: Enhanced performance, USB OTG FS, OCTOSPI, AES
      - Package: LQFP100, LQFP144, UFBGA132, UFBGA169

endchoice

#-----------------------------------------------------------------------------
# Chip Name Definition
#-----------------------------------------------------------------------------

config STM32_CHIP_NAME
    string
    default "STM32L432xx" if STM32L432
    default "STM32L476xx" if STM32L476
    default "STM32L496xx" if STM32L496
    default "STM32L4R5xx" if STM32L4R5
    default "STM32L4S5xx" if STM32L4S5
    help
      STM32 chip name for HAL driver selection and conditional compilation.

#-----------------------------------------------------------------------------
# Memory Configuration
#-----------------------------------------------------------------------------

config STM32_FLASH_SIZE
    hex "Flash size (bytes)"
    default 0x40000 if STM32L432
    default 0x100000 if STM32L476 || STM32L496
    default 0x200000 if STM32L4R5 || STM32L4S5
    help
      Flash memory size in bytes.

config STM32_SRAM_SIZE
    hex "SRAM size (bytes)"
    default 0x10000 if STM32L432
    default 0x20000 if STM32L476
    default 0x50000 if STM32L496
    default 0xA0000 if STM32L4R5 || STM32L4S5
    help
      SRAM memory size in bytes.

#-----------------------------------------------------------------------------
# Series Feature Flags
#-----------------------------------------------------------------------------

config STM32L4_PLUS
    bool
    default y if STM32L4R5 || STM32L4S5
    help
      Whether this is an L4+ variant with enhanced performance (120 MHz).

config STM32L4_HAS_LCD
    bool
    default y if STM32L476 || STM32L496
    help
      Whether the chip has LCD controller.

config STM32L4_HAS_DFSDM
    bool
    default y if STM32L476 || STM32L496
    help
      Whether the chip has DFSDM (Digital Filter for Sigma-Delta Modulators).

config STM32L4_HAS_QSPI
    bool
    default y if STM32L496
    help
      Whether the chip has Quad SPI interface.

config STM32L4_HAS_OCTOSPI
    bool
    default y if STM32L4R5 || STM32L4S5
    help
      Whether the chip has Octo SPI interface.

config STM32L4_HAS_AES
    bool
    default y if STM32L496 || STM32L4S5
    help
      Whether the chip has AES hardware accelerator.

endif # STM32L4
```

## platforms/stm32/src/boot/Kconfig
```kconfig
menu "Boot Configuration"

config STM32_ENABLE_FPU
    bool "Enable FPU (Floating Point Unit)"
    default y
    depends on STM32F4 || STM32F7 || STM32H7
    help
      Enable the Floating Point Unit (FPU) during system initialization.
      The FPU provides hardware acceleration for floating-point operations.

      Available on:
      - STM32F4 series (Cortex-M4F)
      - STM32F7 series (Cortex-M7F)
      - STM32H7 series (Cortex-M7F)

      When enabled, the FPU coprocessors (CP10 and CP11) are granted
      full access during SystemInit().

config STM32_STACK_SIZE
    hex "Stack size (bytes)"
    default 0x1000
    range 0x400 0x10000
    help
      Stack size in bytes for the main stack.
      Default: 0x1000 (4KB)
      Minimum: 0x400 (1KB)
      Maximum: 0x10000 (64KB)

      The stack is used for:
      - Function call frames
      - Local variables
      - Interrupt service routines

      Increase this value if you experience stack overflow or use
      deeply nested function calls.

config STM32_HEAP_SIZE
    hex "Heap size (bytes)"
    default 0x1000
    range 0x400 0x10000
    help
      Heap size in bytes for dynamic memory allocation.
      Default: 0x1000 (4KB)
      Minimum: 0x400 (1KB)
      Maximum: 0x10000 (64KB)

      The heap is used for:
      - malloc() and free() operations
      - C++ new and delete operators
      - Dynamic data structures

      Increase this value if you use dynamic memory allocation
      extensively in your application.

config STM32_ENABLE_CCM
    bool "Enable CCM RAM usage"
    default y
    depends on STM32F4 || STM32F7
    help
      Enable Core Coupled Memory (CCM) RAM usage.
      CCM is a fast SRAM region that is not accessible by DMA.

      Available on:
      - STM32F4 series (64KB at 0x10000000)
      - STM32F7 series (varies by model)

      When enabled, you can place data in CCM using:
        __attribute__((section(".ccmram"))) int my_data;

      Note: CCM cannot be used for DMA buffers.

config STM32_ENABLE_DTCM
    bool "Enable DTCM RAM usage"
    default y
    depends on STM32F7 || STM32H7
    help
      Enable Data Tightly Coupled Memory (DTCM) RAM usage.
      DTCM provides zero wait-state access for the CPU.

      Available on:
      - STM32F7 series (64KB at 0x20000000)
      - STM32H7 series (128KB at 0x20000000)

      DTCM is typically used for stack, heap, and frequently
      accessed variables.

config STM32_ENABLE_ITCM
    bool "Enable ITCM RAM usage"
    default n
    depends on STM32F7 || STM32H7
    help
      Enable Instruction Tightly Coupled Memory (ITCM) RAM usage.
      ITCM provides zero wait-state instruction fetch.

      Available on:
      - STM32F7 series (16KB at 0x00000000)
      - STM32H7 series (64KB at 0x00000000)

      When enabled, you can place time-critical code in ITCM:
        __attribute__((section(".itcmram"))) void fast_function(void);

      Note: Requires special linker script configuration.

config STM32_VTOR_OFFSET
    hex "Vector table offset"
    default 0x00000000
    help
      Offset of the vector table from the base address.
      Default: 0x00000000 (no offset)

      This is typically 0x00000000 for applications running from
      Flash start address (0x08000000).

      Set a non-zero value if:
      - Using a bootloader (e.g., 0x00008000 for 32KB bootloader)
      - Running from RAM
      - Using custom memory layout

config STM32_BOOT_TIMEOUT
    int "Boot timeout (ms)"
    default 100
    range 10 5000
    help
      Maximum time allowed for boot initialization in milliseconds.
      Default: 100ms

      This timeout applies to:
      - Clock configuration
      - HAL library initialization
      - Platform initialization

      If initialization takes longer than this timeout, the system
      will enter error handling mode.

config STM32_ENABLE_BOOT_LOGGING
    bool "Enable boot logging"
    default y if DEBUG
    default n
    help
      Enable logging output during boot process.
      Useful for debugging boot issues.

      When enabled, the boot process will output:
      - Clock configuration status
      - HAL initialization status
      - Platform initialization status
      - Error messages if initialization fails

      Automatically enabled in DEBUG builds.

endmenu
```
