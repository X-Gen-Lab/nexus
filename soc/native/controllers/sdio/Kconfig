## soc/native/controllers/sdio/Kconfig
```kconfig
# SDIO Configuration for Native Platform

config NATIVE_SDIO_ENABLE
    bool "Enable SDIO support for Native platform"
    default y
    depends on PLATFORM_NATIVE
    help
      Enable SDIO (SD/MMC) peripheral support for the Native platform.
      This provides simulated SDIO functionality for testing
      and development on PC.

if NATIVE_SDIO_ENABLE

# SDIO0 Configuration
menuconfig INSTANCE_NX_SDIO_0
    bool "Enable SDIO0"
    default y
    depends on NATIVE_SDIO_ENABLE
    help
      Enable SDIO instance 0.

if INSTANCE_NX_SDIO_0

choice
    prompt "SDIO0 bus width"
    default NX_SDIO0_BUS_WIDTH_4BIT
    depends on INSTANCE_NX_SDIO_0

config NX_SDIO0_BUS_WIDTH_1BIT
    bool "1-bit bus"

config NX_SDIO0_BUS_WIDTH_4BIT
    bool "4-bit bus"

config NX_SDIO0_BUS_WIDTH_8BIT
    bool "8-bit bus"

endchoice

config SDIO0_BUS_WIDTH_VALUE
    int
    default 1 if NX_SDIO0_BUS_WIDTH_1BIT
    default 4 if NX_SDIO0_BUS_WIDTH_4BIT
    default 8 if NX_SDIO0_BUS_WIDTH_8BIT

choice
    prompt "SDIO0 clock speed"
    default NX_SDIO0_CLOCK_MHZ_25
    depends on INSTANCE_NX_SDIO_0

config NX_SDIO0_CLOCK_KHZ_400
    bool "400 kHz (Identification)"

config NX_SDIO0_CLOCK_MHZ_25
    bool "25 MHz (Default Speed)"

config NX_SDIO0_CLOCK_MHZ_50
    bool "50 MHz (High Speed)"

config NX_SDIO0_CLOCK_MHZ_100
    bool "100 MHz (SDR50)"

config NX_SDIO0_CLOCK_MHZ_200
    bool "200 MHz (SDR104)"

endchoice

config SDIO0_CLOCK_VALUE
    int
    default 0 if NX_SDIO0_CLOCK_KHZ_400
    default 1 if NX_SDIO0_CLOCK_MHZ_25
    default 2 if NX_SDIO0_CLOCK_MHZ_50
    default 3 if NX_SDIO0_CLOCK_MHZ_100
    default 4 if NX_SDIO0_CLOCK_MHZ_200

config SDIO0_CLOCK_SPEED
    int
    default 400000 if NX_SDIO0_CLOCK_KHZ_400
    default 25000000 if NX_SDIO0_CLOCK_MHZ_25
    default 50000000 if NX_SDIO0_CLOCK_MHZ_50
    default 100000000 if NX_SDIO0_CLOCK_MHZ_100
    default 200000000 if NX_SDIO0_CLOCK_MHZ_200

config SDIO0_BLOCK_SIZE
    int "SDIO0 block size (bytes)"
    default 512
    range 1 2048
    help
      Block size for SDIO0 in bytes.

config SDIO0_NUM_BLOCKS
    int "SDIO0 number of blocks"
    default 1024
    range 1 1048576
    help
      Number of blocks for simulated SD card.

config SDIO0_CARD_PRESENT
    bool "SDIO0 card present at startup"
    default y
    help
      Simulate SD card presence at startup.

choice
    prompt "SDIO0 card type"
    default NX_SDIO0_CARD_SDHC
    depends on INSTANCE_NX_SDIO_0

config NX_SDIO0_CARD_SDSC
    bool "SDSC (Standard Capacity)"
    help
      SD card up to 2GB.

config NX_SDIO0_CARD_SDHC
    bool "SDHC (High Capacity)"
    help
      SD card 2GB to 32GB.

config NX_SDIO0_CARD_SDXC
    bool "SDXC (Extended Capacity)"
    help
      SD card 32GB to 2TB.

endchoice

config SDIO0_CARD_VALUE
    int
    default 0 if NX_SDIO0_CARD_SDSC
    default 1 if NX_SDIO0_CARD_SDHC
    default 2 if NX_SDIO0_CARD_SDXC

config SDIO0_CARD_TYPE_VALUE
    int
    default 0 if NX_SDIO0_CARD_SDSC
    default 1 if NX_SDIO0_CARD_SDHC
    default 2 if NX_SDIO0_CARD_SDXC

endif # INSTANCE_NX_SDIO_0

# SDIO1 Configuration
menuconfig INSTANCE_NX_SDIO_1
    bool "Enable SDIO1"
    default n
    depends on NATIVE_SDIO_ENABLE
    help
      Enable SDIO instance 1.

if INSTANCE_NX_SDIO_1

choice
    prompt "SDIO1 bus width"
    default NX_SDIO1_BUS_WIDTH_4BIT
    depends on INSTANCE_NX_SDIO_1

config NX_SDIO1_BUS_WIDTH_1BIT
    bool "1-bit bus"

config NX_SDIO1_BUS_WIDTH_4BIT
    bool "4-bit bus"

config NX_SDIO1_BUS_WIDTH_8BIT
    bool "8-bit bus"

endchoice

config SDIO1_BUS_WIDTH_VALUE
    int
    default 1 if NX_SDIO1_BUS_WIDTH_1BIT
    default 4 if NX_SDIO1_BUS_WIDTH_4BIT
    default 8 if NX_SDIO1_BUS_WIDTH_8BIT

choice
    prompt "SDIO1 clock speed"
    default NX_SDIO1_CLOCK_MHZ_25
    depends on INSTANCE_NX_SDIO_1

config NX_SDIO1_CLOCK_KHZ_400
    bool "400 kHz (Identification)"

config NX_SDIO1_CLOCK_MHZ_25
    bool "25 MHz (Default Speed)"

config NX_SDIO1_CLOCK_MHZ_50
    bool "50 MHz (High Speed)"

config NX_SDIO1_CLOCK_MHZ_100
    bool "100 MHz (SDR50)"

config NX_SDIO1_CLOCK_MHZ_200
    bool "200 MHz (SDR104)"

endchoice

config SDIO1_CLOCK_VALUE
    int
    default 0 if NX_SDIO1_CLOCK_KHZ_400
    default 1 if NX_SDIO1_CLOCK_MHZ_25
    default 2 if NX_SDIO1_CLOCK_MHZ_50
    default 3 if NX_SDIO1_CLOCK_MHZ_100
    default 4 if NX_SDIO1_CLOCK_MHZ_200

config SDIO1_CLOCK_SPEED
    int
    default 400000 if NX_SDIO1_CLOCK_KHZ_400
    default 25000000 if NX_SDIO1_CLOCK_MHZ_25
    default 50000000 if NX_SDIO1_CLOCK_MHZ_50
    default 100000000 if NX_SDIO1_CLOCK_MHZ_100
    default 200000000 if NX_SDIO1_CLOCK_MHZ_200

config SDIO1_BLOCK_SIZE
    int "SDIO1 block size (bytes)"
    default 512
    range 1 2048
    help
      Block size for SDIO1 in bytes.

config SDIO1_NUM_BLOCKS
    int "SDIO1 number of blocks"
    default 1024
    range 1 1048576
    help
      Number of blocks for simulated SD card.

config SDIO1_CARD_PRESENT
    bool "SDIO1 card present at startup"
    default y
    help
      Simulate SD card presence at startup.

choice
    prompt "SDIO1 card type"
    default NX_SDIO1_CARD_SDHC
    depends on INSTANCE_NX_SDIO_1

config NX_SDIO1_CARD_SDSC
    bool "SDSC (Standard Capacity)"
    help
      SD card up to 2GB.

config NX_SDIO1_CARD_SDHC
    bool "SDHC (High Capacity)"
    help
      SD card 2GB to 32GB.

config NX_SDIO1_CARD_SDXC
    bool "SDXC (Extended Capacity)"
    help
      SD card 32GB to 2TB.

endchoice

config SDIO1_CARD_VALUE
    int
    default 0 if NX_SDIO1_CARD_SDSC
    default 1 if NX_SDIO1_CARD_SDHC
    default 2 if NX_SDIO1_CARD_SDXC

config SDIO1_CARD_TYPE_VALUE
    int
    default 0 if NX_SDIO1_CARD_SDSC
    default 1 if NX_SDIO1_CARD_SDHC
    default 2 if NX_SDIO1_CARD_SDXC

endif # INSTANCE_NX_SDIO_1

endif # NATIVE_SDIO_ENABLE
```

## soc/native/controllers/spi/Kconfig
```kconfig
# SPI Configuration for Native Platform

config NATIVE_SPI_ENABLE
    bool "Enable SPI support for Native platform"
    default y
    depends on PLATFORM_NATIVE
    help
      Enable SPI peripheral support for the Native platform.
      This provides simulated SPI functionality for testing
      and development on PC.

if NATIVE_SPI_ENABLE

# SPI0 Configuration
menuconfig INSTANCE_NX_SPI_0
    bool "Enable SPI0"
    default y
    depends on NATIVE_SPI_ENABLE
    help
      Enable SPI instance 0.

if INSTANCE_NX_SPI_0

config SPI0_MAX_SPEED
    int "SPI0 maximum speed (Hz)"
    default 1000000
    help
      Maximum SPI speed for SPI0 in Hz (simulated).

choice
    prompt "SPI0 clock polarity"
    default NX_SPI0_CPOL_LOW
    depends on INSTANCE_NX_SPI_0

config NX_SPI0_CPOL_LOW
    bool "Clock polarity low (CPOL=0)"

config NX_SPI0_CPOL_HIGH
    bool "Clock polarity high (CPOL=1)"

endchoice

config SPI0_CPOL_VALUE
    int
    default 0 if NX_SPI0_CPOL_LOW
    default 1 if NX_SPI0_CPOL_HIGH

choice
    prompt "SPI0 clock phase"
    default NX_SPI0_CPHA_EDGE_1
    depends on INSTANCE_NX_SPI_0

config NX_SPI0_CPHA_EDGE_1
    bool "First edge (CPHA=0)"

config NX_SPI0_CPHA_EDGE_2
    bool "Second edge (CPHA=1)"

endchoice

config SPI0_CPHA_VALUE
    int
    default 0 if NX_SPI0_CPHA_EDGE_1
    default 1 if NX_SPI0_CPHA_EDGE_2

choice
    prompt "SPI0 bit order"
    default NX_SPI0_MSB_FIRST
    depends on INSTANCE_NX_SPI_0

config NX_SPI0_MSB_FIRST
    bool "MSB first"

config NX_SPI0_LSB_FIRST
    bool "LSB first"

endchoice

config SPI0_MSB_VALUE
    int
    default 0 if NX_SPI0_MSB_FIRST
    default 1 if NX_SPI0_LSB_FIRST

config SPI0_BIT_ORDER_VALUE
    int
    default 0 if NX_SPI0_MSB_FIRST
    default 1 if NX_SPI0_LSB_FIRST

config SPI0_TX_BUFFER_SIZE
    int "SPI0 TX buffer size"
    default 256
    range 16 4096
    help
      Size of TX buffer for SPI0 in bytes.

config SPI0_RX_BUFFER_SIZE
    int "SPI0 RX buffer size"
    default 256
    range 16 4096
    help
      Size of RX buffer for SPI0 in bytes.

endif # INSTANCE_NX_SPI_0

# SPI1 Configuration
menuconfig INSTANCE_NX_SPI_1
    bool "Enable SPI1"
    default n
    depends on NATIVE_SPI_ENABLE
    help
      Enable SPI instance 1.

if INSTANCE_NX_SPI_1

config SPI1_MAX_SPEED
    int "SPI1 maximum speed (Hz)"
    default 1000000
    help
      Maximum SPI speed for SPI1 in Hz (simulated).

choice
    prompt "SPI1 clock polarity"
    default NX_SPI1_CPOL_LOW
    depends on INSTANCE_NX_SPI_1

config NX_SPI1_CPOL_LOW
    bool "Clock polarity low (CPOL=0)"

config NX_SPI1_CPOL_HIGH
    bool "Clock polarity high (CPOL=1)"

endchoice

config SPI1_CPOL_VALUE
    int
    default 0 if NX_SPI1_CPOL_LOW
    default 1 if NX_SPI1_CPOL_HIGH

choice
    prompt "SPI1 clock phase"
    default NX_SPI1_CPHA_EDGE_1
    depends on INSTANCE_NX_SPI_1

config NX_SPI1_CPHA_EDGE_1
    bool "First edge (CPHA=0)"

config NX_SPI1_CPHA_EDGE_2
    bool "Second edge (CPHA=1)"

endchoice

config SPI1_CPHA_VALUE
    int
    default 0 if NX_SPI1_CPHA_EDGE_1
    default 1 if NX_SPI1_CPHA_EDGE_2

choice
    prompt "SPI1 bit order"
    default NX_SPI1_MSB_FIRST
    depends on INSTANCE_NX_SPI_1

config NX_SPI1_MSB_FIRST
    bool "MSB first"

config NX_SPI1_LSB_FIRST
    bool "LSB first"

endchoice

config SPI1_MSB_VALUE
    int
    default 0 if NX_SPI1_MSB_FIRST
    default 1 if NX_SPI1_LSB_FIRST

config SPI1_BIT_ORDER_VALUE
    int
    default 0 if NX_SPI1_MSB_FIRST
    default 1 if NX_SPI1_LSB_FIRST

config SPI1_TX_BUFFER_SIZE
    int "SPI1 TX buffer size"
    default 256
    range 16 4096
    help
      Size of TX buffer for SPI1 in bytes.

config SPI1_RX_BUFFER_SIZE
    int "SPI1 RX buffer size"
    default 256
    range 16 4096
    help
      Size of RX buffer for SPI1 in bytes.

endif # INSTANCE_NX_SPI_1

# SPI2 Configuration
menuconfig INSTANCE_NX_SPI_2
    bool "Enable SPI2"
    default n
    depends on NATIVE_SPI_ENABLE
    help
      Enable SPI instance 2.

if INSTANCE_NX_SPI_2

config SPI2_MAX_SPEED
    int "SPI2 maximum speed (Hz)"
    default 1000000
    help
      Maximum SPI speed for SPI2 in Hz (simulated).

choice
    prompt "SPI2 clock polarity"
    default NX_SPI2_CPOL_LOW
    depends on INSTANCE_NX_SPI_2

config NX_SPI2_CPOL_LOW
    bool "Clock polarity low (CPOL=0)"

config NX_SPI2_CPOL_HIGH
    bool "Clock polarity high (CPOL=1)"

endchoice

config SPI2_CPOL_VALUE
    int
    default 0 if NX_SPI2_CPOL_LOW
    default 1 if NX_SPI2_CPOL_HIGH

choice
    prompt "SPI2 clock phase"
    default NX_SPI2_CPHA_EDGE_1
    depends on INSTANCE_NX_SPI_2

config NX_SPI2_CPHA_EDGE_1
    bool "First edge (CPHA=0)"

config NX_SPI2_CPHA_EDGE_2
    bool "Second edge (CPHA=1)"

endchoice

config SPI2_CPHA_VALUE
    int
    default 0 if NX_SPI2_CPHA_EDGE_1
    default 1 if NX_SPI2_CPHA_EDGE_2

choice
    prompt "SPI2 bit order"
    default NX_SPI2_MSB_FIRST
    depends on INSTANCE_NX_SPI_2

config NX_SPI2_MSB_FIRST
    bool "MSB first"

config NX_SPI2_LSB_FIRST
    bool "LSB first"

endchoice

config SPI2_MSB_VALUE
    int
    default 0 if NX_SPI2_MSB_FIRST
    default 1 if NX_SPI2_LSB_FIRST

config SPI2_BIT_ORDER_VALUE
    int
    default 0 if NX_SPI2_MSB_FIRST
    default 1 if NX_SPI2_LSB_FIRST

config SPI2_TX_BUFFER_SIZE
    int "SPI2 TX buffer size"
    default 256
    range 16 4096
    help
      Size of TX buffer for SPI2 in bytes.

config SPI2_RX_BUFFER_SIZE
    int "SPI2 RX buffer size"
    default 256
    range 16 4096
    help
      Size of RX buffer for SPI2 in bytes.

endif # INSTANCE_NX_SPI_2

# SPI3 Configuration
menuconfig INSTANCE_NX_SPI_3
    bool "Enable SPI3"
    default n
    depends on NATIVE_SPI_ENABLE
    help
      Enable SPI instance 3.

if INSTANCE_NX_SPI_3

config SPI3_MAX_SPEED
    int "SPI3 maximum speed (Hz)"
    default 1000000
    help
      Maximum SPI speed for SPI3 in Hz (simulated).

choice
    prompt "SPI3 clock polarity"
    default NX_SPI3_CPOL_LOW
    depends on INSTANCE_NX_SPI_3

config NX_SPI3_CPOL_LOW
    bool "Clock polarity low (CPOL=0)"

config NX_SPI3_CPOL_HIGH
    bool "Clock polarity high (CPOL=1)"

endchoice

config SPI3_CPOL_VALUE
    int
    default 0 if NX_SPI3_CPOL_LOW
    default 1 if NX_SPI3_CPOL_HIGH

choice
    prompt "SPI3 clock phase"
    default NX_SPI3_CPHA_EDGE_1
    depends on INSTANCE_NX_SPI_3

config NX_SPI3_CPHA_EDGE_1
    bool "First edge (CPHA=0)"

config NX_SPI3_CPHA_EDGE_2
    bool "Second edge (CPHA=1)"

endchoice

config SPI3_CPHA_VALUE
    int
    default 0 if NX_SPI3_CPHA_EDGE_1
    default 1 if NX_SPI3_CPHA_EDGE_2

choice
    prompt "SPI3 bit order"
    default NX_SPI3_MSB_FIRST
    depends on INSTANCE_NX_SPI_3

config NX_SPI3_MSB_FIRST
    bool "MSB first"

config NX_SPI3_LSB_FIRST
    bool "LSB first"

endchoice

config SPI3_MSB_VALUE
    int
    default 0 if NX_SPI3_MSB_FIRST
    default 1 if NX_SPI3_LSB_FIRST

config SPI3_BIT_ORDER_VALUE
    int
    default 0 if NX_SPI3_MSB_FIRST
    default 1 if NX_SPI3_LSB_FIRST

config SPI3_TX_BUFFER_SIZE
    int "SPI3 TX buffer size"
    default 256
    range 16 4096
    help
      Size of TX buffer for SPI3 in bytes.

config SPI3_RX_BUFFER_SIZE
    int "SPI3 RX buffer size"
    default 256
    range 16 4096
    help
      Size of RX buffer for SPI3 in bytes.

endif # INSTANCE_NX_SPI_3

endif # NATIVE_SPI_ENABLE
```
