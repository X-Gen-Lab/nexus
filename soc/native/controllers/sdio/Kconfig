## soc/native/controllers/uart/Kconfig
```kconfig
# UART Configuration for Native Platform

config NATIVE_UART_ENABLE
    bool "Enable UART support for Native platform"
    default y
    depends on PLATFORM_NATIVE
    help
      Enable UART peripheral support for the Native platform.
      This provides simulated UART functionality for testing
      and development on PC.

if NATIVE_UART_ENABLE

config NATIVE_UART_MAX_INSTANCES
    int "Maximum number of UART instances"
    default 4
    range 1 8
    help
      Maximum number of UART instances supported by the
      Native platform. Each instance requires buffer memory.

# UART0 Configuration
menuconfig INSTANCE_NX_UART_0
    bool "Enable UART0"
    default y
    depends on NATIVE_UART_ENABLE
    help
      Enable UART instance 0.

if INSTANCE_NX_UART_0

config UART0_BAUDRATE
    int "UART0 baud rate"
    default 115200
    help
      Baud rate for UART0 (simulated).

config UART0_DATA_BITS
    int "UART0 data bits"
    default 8
    range 5 9
    help
      Number of data bits for UART0.

config UART0_STOP_BITS
    int "UART0 stop bits"
    default 1
    range 1 2
    help
      Number of stop bits for UART0.

choice
    prompt "UART0 parity"
    default NX_UART0_PARITY_NONE
    depends on INSTANCE_NX_UART_0

config NX_UART0_PARITY_NONE
    bool "None"

config NX_UART0_PARITY_ODD
    bool "Odd"

config NX_UART0_PARITY_EVEN
    bool "Even"

endchoice

config UART0_PARITY_VALUE
    int
    default 0 if NX_UART0_PARITY_NONE
    default 1 if NX_UART0_PARITY_ODD
    default 2 if NX_UART0_PARITY_EVEN

choice
    prompt "UART0 transfer mode"
    default NX_UART0_MODE_INTERRUPT
    depends on INSTANCE_NX_UART_0

config NX_UART0_MODE_POLLING
    bool "Polling"

config NX_UART0_MODE_INTERRUPT
    bool "Interrupt"

config NX_UART0_MODE_DMA
    bool "DMA"

endchoice

config UART0_MODE_VALUE
    int
    default 0 if NX_UART0_MODE_POLLING
    default 1 if NX_UART0_MODE_INTERRUPT
    default 2 if NX_UART0_MODE_DMA

config UART0_TX_BUFFER_SIZE
    int "UART0 TX buffer size"
    default 256
    range 16 4096
    help
      Size of TX buffer for UART0 in bytes.

config UART0_RX_BUFFER_SIZE
    int "UART0 RX buffer size"
    default 256
    range 16 4096
    help
      Size of RX buffer for UART0 in bytes.

endif # INSTANCE_NX_UART_0

# UART1 Configuration
menuconfig INSTANCE_NX_UART_1
    bool "Enable UART1"
    default n
    depends on NATIVE_UART_ENABLE
    help
      Enable UART instance 1.

if INSTANCE_NX_UART_1

config UART1_BAUDRATE
    int "UART1 baud rate"
    default 115200
    help
      Baud rate for UART1 (simulated).

config UART1_DATA_BITS
    int "UART1 data bits"
    default 8
    range 5 9
    help
      Number of data bits for UART1.

config UART1_STOP_BITS
    int "UART1 stop bits"
    default 1
    range 1 2
    help
      Number of stop bits for UART1.

choice
    prompt "UART1 parity"
    default NX_UART1_PARITY_NONE
    depends on INSTANCE_NX_UART_1

config NX_UART1_PARITY_NONE
    bool "None"

config NX_UART1_PARITY_ODD
    bool "Odd"

config NX_UART1_PARITY_EVEN
    bool "Even"

endchoice

config UART1_PARITY_VALUE
    int
    default 0 if NX_UART1_PARITY_NONE
    default 1 if NX_UART1_PARITY_ODD
    default 2 if NX_UART1_PARITY_EVEN

choice
    prompt "UART1 transfer mode"
    default NX_UART1_MODE_INTERRUPT
    depends on INSTANCE_NX_UART_1

config NX_UART1_MODE_POLLING
    bool "Polling"

config NX_UART1_MODE_INTERRUPT
    bool "Interrupt"

config NX_UART1_MODE_DMA
    bool "DMA"

endchoice

config UART1_MODE_VALUE
    int
    default 0 if NX_UART1_MODE_POLLING
    default 1 if NX_UART1_MODE_INTERRUPT
    default 2 if NX_UART1_MODE_DMA

config UART1_TX_BUFFER_SIZE
    int "UART1 TX buffer size"
    default 256
    range 16 4096
    help
      Size of TX buffer for UART1 in bytes.

config UART1_RX_BUFFER_SIZE
    int "UART1 RX buffer size"
    default 256
    range 16 4096
    help
      Size of RX buffer for UART1 in bytes.

endif # INSTANCE_NX_UART_1

# UART2 Configuration
menuconfig INSTANCE_NX_UART_2
    bool "Enable UART2"
    default n
    depends on NATIVE_UART_ENABLE
    help
      Enable UART instance 2.

if INSTANCE_NX_UART_2

config UART2_BAUDRATE
    int "UART2 baud rate"
    default 115200
    help
      Baud rate for UART2 (simulated).

config UART2_DATA_BITS
    int "UART2 data bits"
    default 8
    range 5 9
    help
      Number of data bits for UART2.

config UART2_STOP_BITS
    int "UART2 stop bits"
    default 1
    range 1 2
    help
      Number of stop bits for UART2.

choice
    prompt "UART2 parity"
    default NX_UART2_PARITY_NONE
    depends on INSTANCE_NX_UART_2

config NX_UART2_PARITY_NONE
    bool "None"

config NX_UART2_PARITY_ODD
    bool "Odd"

config NX_UART2_PARITY_EVEN
    bool "Even"

endchoice

config UART2_PARITY_VALUE
    int
    default 0 if NX_UART2_PARITY_NONE
    default 1 if NX_UART2_PARITY_ODD
    default 2 if NX_UART2_PARITY_EVEN

choice
    prompt "UART2 transfer mode"
    default NX_UART2_MODE_INTERRUPT
    depends on INSTANCE_NX_UART_2

config NX_UART2_MODE_POLLING
    bool "Polling"

config NX_UART2_MODE_INTERRUPT
    bool "Interrupt"

config NX_UART2_MODE_DMA
    bool "DMA"

endchoice

config UART2_MODE_VALUE
    int
    default 0 if NX_UART2_MODE_POLLING
    default 1 if NX_UART2_MODE_INTERRUPT
    default 2 if NX_UART2_MODE_DMA

config UART2_TX_BUFFER_SIZE
    int "UART2 TX buffer size"
    default 256
    range 16 4096
    help
      Size of TX buffer for UART2 in bytes.

config UART2_RX_BUFFER_SIZE
    int "UART2 RX buffer size"
    default 256
    range 16 4096
    help
      Size of RX buffer for UART2 in bytes.

endif # INSTANCE_NX_UART_2

# UART3 Configuration
menuconfig INSTANCE_NX_UART_3
    bool "Enable UART3"
    default n
    depends on NATIVE_UART_ENABLE
    help
      Enable UART instance 3.

if INSTANCE_NX_UART_3

config UART3_BAUDRATE
    int "UART3 baud rate"
    default 115200
    help
      Baud rate for UART3 (simulated).

config UART3_DATA_BITS
    int "UART3 data bits"
    default 8
    range 5 9
    help
      Number of data bits for UART3.

config UART3_STOP_BITS
    int "UART3 stop bits"
    default 1
    range 1 2
    help
      Number of stop bits for UART3.

choice
    prompt "UART3 parity"
    default NX_UART3_PARITY_NONE
    depends on INSTANCE_NX_UART_3

config NX_UART3_PARITY_NONE
    bool "None"

config NX_UART3_PARITY_ODD
    bool "Odd"

config NX_UART3_PARITY_EVEN
    bool "Even"

endchoice

config UART3_PARITY_VALUE
    int
    default 0 if NX_UART3_PARITY_NONE
    default 1 if NX_UART3_PARITY_ODD
    default 2 if NX_UART3_PARITY_EVEN

choice
    prompt "UART3 transfer mode"
    default NX_UART3_MODE_INTERRUPT
    depends on INSTANCE_NX_UART_3

config NX_UART3_MODE_POLLING
    bool "Polling"

config NX_UART3_MODE_INTERRUPT
    bool "Interrupt"

config NX_UART3_MODE_DMA
    bool "DMA"

endchoice

config UART3_MODE_VALUE
    int
    default 0 if NX_UART3_MODE_POLLING
    default 1 if NX_UART3_MODE_INTERRUPT
    default 2 if NX_UART3_MODE_DMA

config UART3_TX_BUFFER_SIZE
    int "UART3 TX buffer size"
    default 256
    range 16 4096
    help
      Size of TX buffer for UART3 in bytes.

config UART3_RX_BUFFER_SIZE
    int "UART3 RX buffer size"
    default 256
    range 16 4096
    help
      Size of RX buffer for UART3 in bytes.

endif # INSTANCE_NX_UART_3

endif # NATIVE_UART_ENABLE
```

## soc/native/controllers/usb/Kconfig
```kconfig
# USB Configuration for Native Platform

config NATIVE_USB_ENABLE
    bool "Enable USB support for Native platform"
    default y
    depends on PLATFORM_NATIVE
    help
      Enable USB peripheral support for the Native platform.
      This provides simulated USB functionality for testing
      and development on PC.

if NATIVE_USB_ENABLE

# USB0 Configuration
menuconfig INSTANCE_NX_USB_0
    bool "Enable USB0"
    default y
    depends on NATIVE_USB_ENABLE
    help
      Enable USB instance 0.

if INSTANCE_NX_USB_0

choice
    prompt "USB0 speed"
    default NX_USB0_SPEED_FULL
    depends on INSTANCE_NX_USB_0

config NX_USB0_SPEED_LOW
    bool "Low Speed (1.5 Mbps)"

config NX_USB0_SPEED_FULL
    bool "Full Speed (12 Mbps)"

config NX_USB0_SPEED_HIGH
    bool "High Speed (480 Mbps)"

endchoice

config USB0_SPEED_VALUE
    int
    default 0 if NX_USB0_SPEED_LOW
    default 1 if NX_USB0_SPEED_FULL
    default 2 if NX_USB0_SPEED_HIGH

config USB0_NUM_ENDPOINTS
    int "USB0 number of endpoints"
    default 8
    range 1 16
    help
      Number of USB endpoints for USB0.

config USB0_TX_BUFFER_SIZE
    int "USB0 TX buffer size"
    default 1024
    range 64 4096
    help
      Size of TX buffer for USB0 in bytes.

config USB0_RX_BUFFER_SIZE
    int "USB0 RX buffer size"
    default 1024
    range 64 4096
    help
      Size of RX buffer for USB0 in bytes.

choice
    prompt "USB0 power mode"
    default NX_USB0_POWER_BUS
    depends on INSTANCE_NX_USB_0

config NX_USB0_POWER_BUS
    bool "Bus powered"

config NX_USB0_POWER_SELF
    bool "Self powered"

endchoice

config USB0_POWER_VALUE
    int
    default 0 if NX_USB0_POWER_BUS
    default 1 if NX_USB0_POWER_SELF

config USB0_MAX_POWER_MA
    int "USB0 maximum power (mA)"
    default 500
    range 0 500
    help
      Maximum power consumption for USB0 in milliamps.

endif # INSTANCE_NX_USB_0

# USB1 Configuration
menuconfig INSTANCE_NX_USB_1
    bool "Enable USB1"
    default n
    depends on NATIVE_USB_ENABLE
    help
      Enable USB instance 1.

if INSTANCE_NX_USB_1

choice
    prompt "USB1 speed"
    default NX_USB1_SPEED_FULL
    depends on INSTANCE_NX_USB_1

config NX_USB1_SPEED_LOW
    bool "Low Speed (1.5 Mbps)"

config NX_USB1_SPEED_FULL
    bool "Full Speed (12 Mbps)"

config NX_USB1_SPEED_HIGH
    bool "High Speed (480 Mbps)"

endchoice

config USB1_SPEED_VALUE
    int
    default 0 if NX_USB1_SPEED_LOW
    default 1 if NX_USB1_SPEED_FULL
    default 2 if NX_USB1_SPEED_HIGH

config USB1_NUM_ENDPOINTS
    int "USB1 number of endpoints"
    default 8
    range 1 16
    help
      Number of USB endpoints for USB1.

config USB1_TX_BUFFER_SIZE
    int "USB1 TX buffer size"
    default 1024
    range 64 4096
    help
      Size of TX buffer for USB1 in bytes.

config USB1_RX_BUFFER_SIZE
    int "USB1 RX buffer size"
    default 1024
    range 64 4096
    help
      Size of RX buffer for USB1 in bytes.

choice
    prompt "USB1 power mode"
    default NX_USB1_POWER_BUS
    depends on INSTANCE_NX_USB_1

config NX_USB1_POWER_BUS
    bool "Bus powered"

config NX_USB1_POWER_SELF
    bool "Self powered"

endchoice

config USB1_POWER_VALUE
    int
    default 0 if NX_USB1_POWER_BUS
    default 1 if NX_USB1_POWER_SELF

config USB1_MAX_POWER_MA
    int "USB1 maximum power (mA)"
    default 500
    range 0 500
    help
      Maximum power consumption for USB1 in milliamps.

endif # INSTANCE_NX_USB_1

endif # NATIVE_USB_ENABLE
```
