## platforms/stm32/src/uart/Kconfig
```kconfig
#
# UART Configuration for STM32 Platform
#
# This file defines UART peripheral configuration for STM32 chips.
# It includes instance configuration, transfer modes, and pin settings.
#

config STM32_UART_MAX_INSTANCES
    int "Maximum number of UART instances"
    default 6
    range 1 8
    depends on STM32_UART_ENABLE
    help
      Maximum number of UART instances supported by the STM32 chip.
      Actual availability depends on the selected chip variant.

#
# UART1 Configuration
#
menuconfig INSTANCE_NX_UART_1
    bool "Enable UART1"
    default y
    depends on STM32_UART_ENABLE
    help
      Enable UART instance 1.

if INSTANCE_NX_UART_1

config UART1_BAUDRATE
    int "UART1 baud rate"
    default 115200
    help
      Baud rate for UART1.
      Common values: 9600, 19200, 38400, 57600, 115200, 230400, 460800

config UART1_DATA_BITS
    int "UART1 data bits"
    default 8
    range 7 9
    help
      Number of data bits for UART1.
      Typical values: 7, 8, or 9 bits

config UART1_STOP_BITS
    int "UART1 stop bits"
    default 1
    range 1 2
    help
      Number of stop bits for UART1.
      1 = One stop bit, 2 = Two stop bits

choice
    prompt "UART1 parity"
    default NX_UART1_PARITY_NONE
    help
      Parity setting for UART1.

config NX_UART1_PARITY_NONE
    bool "None"

config NX_UART1_PARITY_ODD
    bool "Odd"

config NX_UART1_PARITY_EVEN
    bool "Even"

endchoice

config UART1_PARITY_VALUE
    int
    default 0 if NX_UART1_PARITY_NONE
    default 1 if NX_UART1_PARITY_ODD
    default 2 if NX_UART1_PARITY_EVEN
    help
      Internal parity value for code generation.

choice
    prompt "UART1 transfer mode"
    default NX_UART1_MODE_DMA
    help
      Transfer mode for UART1.
      - Polling: Simple but blocks CPU
      - Interrupt: Efficient for low data rates
      - DMA: Best for high data rates

config NX_UART1_MODE_POLLING
    bool "Polling"

config NX_UART1_MODE_INTERRUPT
    bool "Interrupt"

config NX_UART1_MODE_DMA
    bool "DMA"

endchoice

config UART1_MODE_VALUE
    int
    default 0 if NX_UART1_MODE_POLLING
    default 1 if NX_UART1_MODE_INTERRUPT
    default 2 if NX_UART1_MODE_DMA
    help
      Internal mode value for code generation.

config UART1_TX_BUFFER_SIZE
    int "UART1 TX buffer size"
    default 256
    range 16 4096
    help
      Size of TX buffer for UART1 in bytes.

config UART1_RX_BUFFER_SIZE
    int "UART1 RX buffer size"
    default 256
    range 16 4096
    help
      Size of RX buffer for UART1 in bytes.

config UART1_DMA_TX_CHANNEL
    int "UART1 DMA TX channel"
    default 4
    range 0 15
    depends on NX_UART1_MODE_DMA
    help
      DMA channel for UART1 TX transfers.

config UART1_DMA_RX_CHANNEL
    int "UART1 DMA RX channel"
    default 5
    range 0 15
    depends on NX_UART1_MODE_DMA
    help
      DMA channel for UART1 RX transfers.

menu "UART1 Pin Configuration"

config UART1_TX_PIN
    int "TX pin"
    default 9
    help
      TX pin number (e.g., PA9 = 9).

config UART1_RX_PIN
    int "RX pin"
    default 10
    help
      RX pin number (e.g., PA10 = 10).

config UART1_TX_PORT
    string "TX port"
    default "GPIOA"
    help
      TX GPIO port (e.g., GPIOA, GPIOB).

config UART1_RX_PORT
    string "RX port"
    default "GPIOA"
    help
      RX GPIO port (e.g., GPIOA, GPIOB).

endmenu

endif # INSTANCE_NX_UART_1

#
# UART2 Configuration
#
menuconfig INSTANCE_NX_UART_2
    bool "Enable UART2"
    default n
    depends on STM32_UART_ENABLE
    help
      Enable UART instance 2.

if INSTANCE_NX_UART_2

config UART2_BAUDRATE
    int "UART2 baud rate"
    default 115200
    help
      Baud rate for UART2.

config UART2_DATA_BITS
    int "UART2 data bits"
    default 8
    range 7 9
    help
      Number of data bits for UART2.

config UART2_STOP_BITS
    int "UART2 stop bits"
    default 1
    range 1 2
    help
      Number of stop bits for UART2.

choice
    prompt "UART2 parity"
    default NX_UART2_PARITY_NONE

config NX_UART2_PARITY_NONE
    bool "None"

config NX_UART2_PARITY_ODD
    bool "Odd"

config NX_UART2_PARITY_EVEN
    bool "Even"

endchoice

config UART2_PARITY_VALUE
    int
    default 0 if NX_UART2_PARITY_NONE
    default 1 if NX_UART2_PARITY_ODD
    default 2 if NX_UART2_PARITY_EVEN

choice
    prompt "UART2 transfer mode"
    default NX_UART2_MODE_DMA

config NX_UART2_MODE_POLLING
    bool "Polling"

config NX_UART2_MODE_INTERRUPT
    bool "Interrupt"

config NX_UART2_MODE_DMA
    bool "DMA"

endchoice

config UART2_MODE_VALUE
    int
    default 0 if NX_UART2_MODE_POLLING
    default 1 if NX_UART2_MODE_INTERRUPT
    default 2 if NX_UART2_MODE_DMA

config UART2_TX_BUFFER_SIZE
    int "UART2 TX buffer size"
    default 256
    range 16 4096
    help
      Size of TX buffer for UART2 in bytes.

config UART2_RX_BUFFER_SIZE
    int "UART2 RX buffer size"
    default 256
    range 16 4096
    help
      Size of RX buffer for UART2 in bytes.

config UART2_DMA_TX_CHANNEL
    int "UART2 DMA TX channel"
    default 6
    range 0 15
    depends on NX_UART2_MODE_DMA

config UART2_DMA_RX_CHANNEL
    int "UART2 DMA RX channel"
    default 7
    range 0 15
    depends on NX_UART2_MODE_DMA

menu "UART2 Pin Configuration"

config UART2_TX_PIN
    int "TX pin"
    default 2
    help
      TX pin number (e.g., PA2 = 2).

config UART2_RX_PIN
    int "RX pin"
    default 3
    help
      RX pin number (e.g., PA3 = 3).

config UART2_TX_PORT
    string "TX port"
    default "GPIOA"

config UART2_RX_PORT
    string "RX port"
    default "GPIOA"

endmenu

endif # INSTANCE_NX_UART_2

#
# UART3 Configuration
#
menuconfig INSTANCE_NX_UART_3
    bool "Enable UART3"
    default n
    depends on STM32_UART_ENABLE
    help
      Enable UART instance 3.

if INSTANCE_NX_UART_3

config UART3_BAUDRATE
    int "UART3 baud rate"
    default 115200

config UART3_DATA_BITS
    int "UART3 data bits"
    default 8
    range 7 9

config UART3_STOP_BITS
    int "UART3 stop bits"
    default 1
    range 1 2

choice
    prompt "UART3 parity"
    default NX_UART3_PARITY_NONE

config NX_UART3_PARITY_NONE
    bool "None"

config NX_UART3_PARITY_ODD
    bool "Odd"

config NX_UART3_PARITY_EVEN
    bool "Even"

endchoice

config UART3_PARITY_VALUE
    int
    default 0 if NX_UART3_PARITY_NONE
    default 1 if NX_UART3_PARITY_ODD
    default 2 if NX_UART3_PARITY_EVEN

choice
    prompt "UART3 transfer mode"
    default NX_UART3_MODE_DMA

config NX_UART3_MODE_POLLING
    bool "Polling"

config NX_UART3_MODE_INTERRUPT
    bool "Interrupt"

config NX_UART3_MODE_DMA
    bool "DMA"

endchoice

config UART3_MODE_VALUE
    int
    default 0 if NX_UART3_MODE_POLLING
    default 1 if NX_UART3_MODE_INTERRUPT
    default 2 if NX_UART3_MODE_DMA

config UART3_TX_BUFFER_SIZE
    int "UART3 TX buffer size"
    default 256
    range 16 4096

config UART3_RX_BUFFER_SIZE
    int "UART3 RX buffer size"
    default 256
    range 16 4096

config UART3_DMA_TX_CHANNEL
    int "UART3 DMA TX channel"
    default 2
    range 0 15
    depends on NX_UART3_MODE_DMA

config UART3_DMA_RX_CHANNEL
    int "UART3 DMA RX channel"
    default 3
    range 0 15
    depends on NX_UART3_MODE_DMA

menu "UART3 Pin Configuration"

config UART3_TX_PIN
    int "TX pin"
    default 10
    help
      TX pin number (e.g., PB10 = 10).

config UART3_RX_PIN
    int "RX pin"
    default 11
    help
      RX pin number (e.g., PB11 = 11).

config UART3_TX_PORT
    string "TX port"
    default "GPIOB"

config UART3_RX_PORT
    string "RX port"
    default "GPIOB"

endmenu

endif # INSTANCE_NX_UART_3
```

## soc/native/controllers/crc/Kconfig
```kconfig
# CRC Configuration for Native Platform

config NATIVE_CRC_ENABLE
    bool "Enable CRC support for Native platform"
    default y
    depends on PLATFORM_NATIVE
    help
      Enable CRC peripheral support for the Native platform.
      This provides simulated CRC functionality for testing
      and development on PC.

if NATIVE_CRC_ENABLE

# CRC0 Configuration
menuconfig INSTANCE_NX_CRC_0
    bool "Enable CRC0"
    default y
    depends on NATIVE_CRC_ENABLE
    help
      Enable CRC instance 0.

if INSTANCE_NX_CRC_0

choice
    prompt "CRC0 algorithm"
    default NX_CRC0_ALGORITHM_CRC32
    depends on INSTANCE_NX_CRC_0

config NX_CRC0_ALGORITHM_CRC32
    bool "CRC-32 (IEEE 802.3)"
    help
      Use CRC-32 algorithm with polynomial 0x04C11DB7.

config NX_CRC0_ALGORITHM_CRC16
    bool "CRC-16 (CCITT)"
    help
      Use CRC-16 CCITT algorithm with polynomial 0x1021.

config NX_CRC0_ALGORITHM_CRC8
    bool "CRC-8"
    help
      Use CRC-8 algorithm with polynomial 0x07.

endchoice

config NX_CRC0_ALGORITHM_VALUE
    int
    default 0 if NX_CRC0_ALGORITHM_CRC32
    default 1 if NX_CRC0_ALGORITHM_CRC16
    default 2 if NX_CRC0_ALGORITHM_CRC8

config NX_CRC0_POLYNOMIAL
    hex "CRC0 polynomial"
    default 0x04C11DB7 if NX_CRC0_ALGORITHM_CRC32
    default 0x1021 if NX_CRC0_ALGORITHM_CRC16
    default 0x07 if NX_CRC0_ALGORITHM_CRC8
    help
      CRC polynomial value for CRC0.
      Default: 0x04C11DB7 for CRC-32, 0x1021 for CRC-16, 0x07 for CRC-8.

config NX_CRC0_INIT_VALUE
    hex "CRC0 initial value"
    default 0xFFFFFFFF if NX_CRC0_ALGORITHM_CRC32
    default 0xFFFF if NX_CRC0_ALGORITHM_CRC16
    default 0xFF if NX_CRC0_ALGORITHM_CRC8
    help
      Initial CRC value for CRC0.
      Default: 0xFFFFFFFF for CRC-32, 0xFFFF for CRC-16, 0xFF for CRC-8.

config NX_CRC0_FINAL_XOR
    hex "CRC0 final XOR value"
    default 0xFFFFFFFF if NX_CRC0_ALGORITHM_CRC32
    default 0x0000 if NX_CRC0_ALGORITHM_CRC16
    default 0x00 if NX_CRC0_ALGORITHM_CRC8
    help
      Final XOR value applied to CRC result.
      Default: 0xFFFFFFFF for CRC-32, 0x0000 for CRC-16, 0x00 for CRC-8.

choice
    prompt "CRC0 input data format"
    default NX_CRC0_INPUT_BYTE
    depends on INSTANCE_NX_CRC_0

config NX_CRC0_INPUT_BYTE
    bool "Byte (8-bit)"

config NX_CRC0_INPUT_HALFWORD
    bool "Half-word (16-bit)"

config NX_CRC0_INPUT_WORD
    bool "Word (32-bit)"

endchoice

config NX_CRC0_INPUT_VALUE
    int
    default 0 if NX_CRC0_INPUT_BYTE
    default 1 if NX_CRC0_INPUT_HALFWORD
    default 2 if NX_CRC0_INPUT_WORD

config NX_CRC0_INPUT_FORMAT_VALUE
    int
    default 0 if NX_CRC0_INPUT_BYTE
    default 1 if NX_CRC0_INPUT_HALFWORD
    default 2 if NX_CRC0_INPUT_WORD

endif # INSTANCE_NX_CRC_0

# CRC1 Configuration
menuconfig INSTANCE_NX_CRC_1
    bool "Enable CRC1"
    default n
    depends on NATIVE_CRC_ENABLE
    help
      Enable CRC instance 1.

if INSTANCE_NX_CRC_1

choice
    prompt "CRC1 algorithm"
    default NX_CRC1_ALGORITHM_CRC32
    depends on INSTANCE_NX_CRC_1

config NX_CRC1_ALGORITHM_CRC32
    bool "CRC-32 (IEEE 802.3)"
    help
      Use CRC-32 algorithm with polynomial 0x04C11DB7.

config NX_CRC1_ALGORITHM_CRC16
    bool "CRC-16 (CCITT)"
    help
      Use CRC-16 CCITT algorithm with polynomial 0x1021.

config NX_CRC1_ALGORITHM_CRC8
    bool "CRC-8"
    help
      Use CRC-8 algorithm with polynomial 0x07.

endchoice

config NX_CRC1_ALGORITHM_VALUE
    int
    default 0 if NX_CRC1_ALGORITHM_CRC32
    default 1 if NX_CRC1_ALGORITHM_CRC16
    default 2 if NX_CRC1_ALGORITHM_CRC8

config NX_CRC1_POLYNOMIAL
    hex "CRC1 polynomial"
    default 0x04C11DB7 if NX_CRC1_ALGORITHM_CRC32
    default 0x1021 if NX_CRC1_ALGORITHM_CRC16
    default 0x07 if NX_CRC1_ALGORITHM_CRC8
    help
      CRC polynomial value for CRC1.

config NX_CRC1_INIT_VALUE
    hex "CRC1 initial value"
    default 0xFFFFFFFF if NX_CRC1_ALGORITHM_CRC32
    default 0xFFFF if NX_CRC1_ALGORITHM_CRC16
    default 0xFF if NX_CRC1_ALGORITHM_CRC8
    help
      Initial CRC value for CRC1.

config NX_CRC1_FINAL_XOR
    hex "CRC1 final XOR value"
    default 0xFFFFFFFF if NX_CRC1_ALGORITHM_CRC32
    default 0x0000 if NX_CRC1_ALGORITHM_CRC16
    default 0x00 if NX_CRC1_ALGORITHM_CRC8
    help
      Final XOR value applied to CRC result.

choice
    prompt "CRC1 input data format"
    default NX_CRC1_INPUT_BYTE
    depends on INSTANCE_NX_CRC_1

config NX_CRC1_INPUT_BYTE
    bool "Byte (8-bit)"

config NX_CRC1_INPUT_HALFWORD
    bool "Half-word (16-bit)"

config NX_CRC1_INPUT_WORD
    bool "Word (32-bit)"

endchoice

config NX_CRC1_INPUT_VALUE
    int
    default 0 if NX_CRC1_INPUT_BYTE
    default 1 if NX_CRC1_INPUT_HALFWORD
    default 2 if NX_CRC1_INPUT_WORD

config NX_CRC1_INPUT_FORMAT_VALUE
    int
    default 0 if NX_CRC1_INPUT_BYTE
    default 1 if NX_CRC1_INPUT_HALFWORD
    default 2 if NX_CRC1_INPUT_WORD

endif # INSTANCE_NX_CRC_1

endif # NATIVE_CRC_ENABLE
```

## soc/native/controllers/flash/Kconfig
```kconfig
# Flash Configuration for Native Platform

config NATIVE_FLASH_ENABLE
    bool "Enable Internal Flash support for Native platform"
    default y
    depends on PLATFORM_NATIVE
    help
      Enable Internal Flash peripheral support for the Native platform.
      This provides simulated Flash memory functionality for testing
      and development on PC.

if NATIVE_FLASH_ENABLE

# Flash0 Configuration
menuconfig INSTANCE_NX_INTERNAL_FLASH0
    bool "Enable FLASH0"
    default y
    depends on NATIVE_FLASH_ENABLE
    help
      Enable Internal Flash instance 0.

if INSTANCE_NX_INTERNAL_FLASH0

config FLASH0_SIZE_KB
    int "FLASH0 size (KB)"
    default 512
    range 64 2048
    help
      Total flash size for FLASH0 in kilobytes.

config FLASH0_SECTOR_SIZE_KB
    int "FLASH0 sector size (KB)"
    default 4
    range 1 128
    help
      Sector size for FLASH0 in kilobytes.

config FLASH0_PAGE_SIZE_BYTES
    int "FLASH0 page size (bytes)"
    default 256
    range 64 2048
    help
      Page size for FLASH0 in bytes.

choice
    prompt "FLASH0 write protection"
    default NX_FLASH0_WP_DISABLED
    depends on INSTANCE_NX_INTERNAL_FLASH0

config NX_FLASH0_WP_DISABLED
    bool "Disabled"
    help
      No write protection.

config NX_FLASH0_WP_ENABLED
    bool "Enabled"
    help
      Enable write protection for specified sectors.

endchoice

config FLASH0_WP_VALUE
    int
    default 0 if NX_FLASH0_WP_DISABLED
    default 1 if NX_FLASH0_WP_ENABLED

config FLASH0_BACKING_FILE
    string "FLASH0 backing file path"
    default "native_flash0.bin"
    help
      Path to backing file for persistent flash storage simulation.

endif # INSTANCE_NX_INTERNAL_FLASH0

endif # NATIVE_FLASH_ENABLE
```
