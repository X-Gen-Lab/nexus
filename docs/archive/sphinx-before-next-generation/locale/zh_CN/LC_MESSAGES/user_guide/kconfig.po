## platforms/native/src/gpio/Kconfig
```kconfig
#GPIO Configuration for Native Platform

config NATIVE_GPIO_ENABLE
    bool "Enable GPIO support for Native platform"
    default y
    depends on PLATFORM_NATIVE
    help
      Enable GPIO peripheral support for the Native platform.
      This provides simulated GPIO functionality for testing
      and development on PC.

if NATIVE_GPIO_ENABLE

#GPIOA Configuration
menuconfig INSTANCE_NX_GPIOA
    bool "Enable GPIOA"
    default y
    depends on NATIVE_GPIO_ENABLE
    help
      Enable GPIO port A.

if INSTANCE_NX_GPIOA

menuconfig INSTANCE_NX_GPIOA_PIN0
    bool "Enable GPIOA PIN0"
    default y
    help
      Enable GPIOA pin 0.

if INSTANCE_NX_GPIOA_PIN0

choice
    prompt "GPIOA PIN0 mode"
    default NX_GPIOA_PIN0_MODE_OUTPUT_PP
    depends on INSTANCE_NX_GPIOA_PIN0

config NX_GPIOA_PIN0_MODE_INPUT
    bool "Input"

config NX_GPIOA_PIN0_MODE_OUTPUT_PP
    bool "Output Push-Pull"

config NX_GPIOA_PIN0_MODE_OUTPUT_OD
    bool "Output Open-Drain"

config NX_GPIOA_PIN0_MODE_AF_PP
    bool "Alternate Function Push-Pull"

config NX_GPIOA_PIN0_MODE_AF_OD
    bool "Alternate Function Open-Drain"

config NX_GPIOA_PIN0_MODE_ANALOG
    bool "Analog"

endchoice

config GPIOA_PIN0_MODE
    int
    default 0 if NX_GPIOA_PIN0_MODE_INPUT
    default 1 if NX_GPIOA_PIN0_MODE_OUTPUT_PP
    default 2 if NX_GPIOA_PIN0_MODE_OUTPUT_OD
    default 3 if NX_GPIOA_PIN0_MODE_AF_PP
    default 4 if NX_GPIOA_PIN0_MODE_AF_OD
    default 5 if NX_GPIOA_PIN0_MODE_ANALOG

choice
    prompt "GPIOA PIN0 pull configuration"
    default NX_GPIOA_PIN0_PULL_NONE
    depends on INSTANCE_NX_GPIOA_PIN0

config NX_GPIOA_PIN0_PULL_NONE
    bool "No pull-up/pull-down"

config NX_GPIOA_PIN0_PULL_UP
    bool "Pull-up"

config NX_GPIOA_PIN0_PULL_DOWN
    bool "Pull-down"

endchoice

config GPIOA_PIN0_PULL_VALUE
    int
    default 0 if NX_GPIOA_PIN0_PULL_NONE
    default 1 if NX_GPIOA_PIN0_PULL_UP
    default 2 if NX_GPIOA_PIN0_PULL_DOWN

choice
    prompt "GPIOA PIN0 speed"
    default NX_GPIOA_PIN0_SPEED_MEDIUM
    depends on INSTANCE_NX_GPIOA_PIN0

config NX_GPIOA_PIN0_SPEED_LOW
    bool "Low speed"

config NX_GPIOA_PIN0_SPEED_MEDIUM
    bool "Medium speed"

config NX_GPIOA_PIN0_SPEED_HIGH
    bool "High speed"

config NX_GPIOA_PIN0_SPEED_VERY_HIGH
    bool "Very high speed"

endchoice

config GPIOA_PIN0_SPEED_VALUE
    int
    default 0 if NX_GPIOA_PIN0_SPEED_LOW
    default 1 if NX_GPIOA_PIN0_SPEED_MEDIUM
    default 2 if NX_GPIOA_PIN0_SPEED_HIGH
    default 3 if NX_GPIOA_PIN0_SPEED_VERY_HIGH

config GPIOA_PIN0_OUTPUT_VALUE
    int "GPIOA PIN0 initial output value"
    default 0
    range 0 1
    help
      Initial output value for GPIOA PIN0:
      0 = Low, 1 = High

endif # INSTANCE_NX_GPIOA_PIN0

menuconfig INSTANCE_NX_GPIOA_PIN1
    bool "Enable GPIOA PIN1"
    default n
    help
      Enable GPIOA pin 1.

if INSTANCE_NX_GPIOA_PIN1

choice
    prompt "GPIOA PIN1 mode"
    default NX_GPIOA_PIN1_MODE_OUTPUT_PP
    depends on INSTANCE_NX_GPIOA_PIN1

config NX_GPIOA_PIN1_MODE_INPUT
    bool "Input"

config NX_GPIOA_PIN1_MODE_OUTPUT_PP
    bool "Output Push-Pull"

config NX_GPIOA_PIN1_MODE_OUTPUT_OD
    bool "Output Open-Drain"

config NX_GPIOA_PIN1_MODE_AF_PP
    bool "Alternate Function Push-Pull"

config NX_GPIOA_PIN1_MODE_AF_OD
    bool "Alternate Function Open-Drain"

config NX_GPIOA_PIN1_MODE_ANALOG
    bool "Analog"

endchoice

config GPIOA_PIN1_MODE
    int
    default 0 if NX_GPIOA_PIN1_MODE_INPUT
    default 1 if NX_GPIOA_PIN1_MODE_OUTPUT_PP
    default 2 if NX_GPIOA_PIN1_MODE_OUTPUT_OD
    default 3 if NX_GPIOA_PIN1_MODE_AF_PP
    default 4 if NX_GPIOA_PIN1_MODE_AF_OD
    default 5 if NX_GPIOA_PIN1_MODE_ANALOG

choice
    prompt "GPIOA PIN1 pull configuration"
    default NX_GPIOA_PIN1_PULL_NONE
    depends on INSTANCE_NX_GPIOA_PIN1

config NX_GPIOA_PIN1_PULL_NONE
    bool "No pull-up/pull-down"

config NX_GPIOA_PIN1_PULL_UP
    bool "Pull-up"

config NX_GPIOA_PIN1_PULL_DOWN
    bool "Pull-down"

endchoice

config GPIOA_PIN1_PULL_VALUE
    int
    default 0 if NX_GPIOA_PIN1_PULL_NONE
    default 1 if NX_GPIOA_PIN1_PULL_UP
    default 2 if NX_GPIOA_PIN1_PULL_DOWN

choice
    prompt "GPIOA PIN1 speed"
    default NX_GPIOA_PIN1_SPEED_MEDIUM
    depends on INSTANCE_NX_GPIOA_PIN1

config NX_GPIOA_PIN1_SPEED_LOW
    bool "Low speed"

config NX_GPIOA_PIN1_SPEED_MEDIUM
    bool "Medium speed"

config NX_GPIOA_PIN1_SPEED_HIGH
    bool "High speed"

config NX_GPIOA_PIN1_SPEED_VERY_HIGH
    bool "Very high speed"

endchoice

config GPIOA_PIN1_SPEED_VALUE
    int
    default 0 if NX_GPIOA_PIN1_SPEED_LOW
    default 1 if NX_GPIOA_PIN1_SPEED_MEDIUM
    default 2 if NX_GPIOA_PIN1_SPEED_HIGH
    default 3 if NX_GPIOA_PIN1_SPEED_VERY_HIGH

config GPIOA_PIN1_OUTPUT_VALUE
    int "GPIOA PIN1 initial output value"
    default 0
    range 0 1
    help
      Initial output value for GPIOA PIN1:
      0 = Low, 1 = High

endif # INSTANCE_NX_GPIOA_PIN1


menuconfig INSTANCE_NX_GPIOA_PIN2
    bool "Enable GPIOA PIN2"
    default y
    help
      Enable GPIOA pin 2.

if INSTANCE_NX_GPIOA_PIN2

choice
    prompt "GPIOA PIN2 mode"
    default NX_GPIOA_PIN2_MODE_OUTPUT_PP
    depends on INSTANCE_NX_GPIOA_PIN2

config NX_GPIOA_PIN2_MODE_INPUT
    bool "Input"

config NX_GPIOA_PIN2_MODE_OUTPUT_PP
    bool "Output Push-Pull"

config NX_GPIOA_PIN2_MODE_OUTPUT_OD
    bool "Output Open-Drain"

config NX_GPIOA_PIN2_MODE_AF_PP
    bool "Alternate Function Push-Pull"

config NX_GPIOA_PIN2_MODE_AF_OD
    bool "Alternate Function Open-Drain"

config NX_GPIOA_PIN2_MODE_ANALOG
    bool "Analog"

endchoice

config GPIOA_PIN2_MODE
    int
    default 0 if NX_GPIOA_PIN2_MODE_INPUT
    default 1 if NX_GPIOA_PIN2_MODE_OUTPUT_PP
    default 2 if NX_GPIOA_PIN2_MODE_OUTPUT_OD
    default 3 if NX_GPIOA_PIN2_MODE_AF_PP
    default 4 if NX_GPIOA_PIN2_MODE_AF_OD
    default 5 if NX_GPIOA_PIN2_MODE_ANALOG

choice
    prompt "GPIOA PIN2 pull configuration"
    default NX_GPIOA_PIN2_PULL_NONE
    depends on INSTANCE_NX_GPIOA_PIN2

config NX_GPIOA_PIN2_PULL_NONE
    bool "No pull-up/pull-down"

config NX_GPIOA_PIN2_PULL_UP
    bool "Pull-up"

config NX_GPIOA_PIN2_PULL_DOWN
    bool "Pull-down"

endchoice

config GPIOA_PIN2_PULL_VALUE
    int
    default 0 if NX_GPIOA_PIN2_PULL_NONE
    default 1 if NX_GPIOA_PIN2_PULL_UP
    default 2 if NX_GPIOA_PIN2_PULL_DOWN

choice
    prompt "GPIOA PIN2 speed"
    default NX_GPIOA_PIN2_SPEED_MEDIUM
    depends on INSTANCE_NX_GPIOA_PIN2

config NX_GPIOA_PIN2_SPEED_LOW
    bool "Low speed"

config NX_GPIOA_PIN2_SPEED_MEDIUM
    bool "Medium speed"

config NX_GPIOA_PIN2_SPEED_HIGH
    bool "High speed"

config NX_GPIOA_PIN2_SPEED_VERY_HIGH
    bool "Very high speed"

endchoice

config GPIOA_PIN2_SPEED_VALUE
    int
    default 0 if NX_GPIOA_PIN2_SPEED_LOW
    default 1 if NX_GPIOA_PIN2_SPEED_MEDIUM
    default 2 if NX_GPIOA_PIN2_SPEED_HIGH
    default 3 if NX_GPIOA_PIN2_SPEED_VERY_HIGH

config GPIOA_PIN2_OUTPUT_VALUE
    int "GPIOA PIN2 initial output value"
    default 0
    range 0 1
    help
      Initial output value for GPIOA PIN2:
      0 = Low, 1 = High

endif # INSTANCE_NX_GPIOA_PIN2

endif # INSTANCE_NX_GPIOA

#GPIOB Configuration
menuconfig INSTANCE_NX_GPIOB
    bool "Enable GPIOB"
    default n
    depends on NATIVE_GPIO_ENABLE
    help
      Enable GPIO port B.

if INSTANCE_NX_GPIOB

menuconfig INSTANCE_NX_GPIOB_PIN0
    bool "Enable GPIOB PIN0"
    default y
    help
      Enable GPIOB pin 0.

if INSTANCE_NX_GPIOB_PIN0

choice
    prompt "GPIOB PIN0 mode"
    default NX_GPIOB_PIN0_MODE_OUTPUT_PP
    depends on INSTANCE_NX_GPIOB_PIN0

config NX_GPIOB_PIN0_MODE_INPUT
    bool "Input"

config NX_GPIOB_PIN0_MODE_OUTPUT_PP
    bool "Output Push-Pull"

config NX_GPIOB_PIN0_MODE_OUTPUT_OD
    bool "Output Open-Drain"

config NX_GPIOB_PIN0_MODE_AF_PP
    bool "Alternate Function Push-Pull"

config NX_GPIOB_PIN0_MODE_AF_OD
    bool "Alternate Function Open-Drain"

config NX_GPIOB_PIN0_MODE_ANALOG
    bool "Analog"

endchoice

config GPIOB_PIN0_MODE
    int
    default 0 if NX_GPIOB_PIN0_MODE_INPUT
    default 1 if NX_GPIOB_PIN0_MODE_OUTPUT_PP
    default 2 if NX_GPIOB_PIN0_MODE_OUTPUT_OD
    default 3 if NX_GPIOB_PIN0_MODE_AF_PP
    default 4 if NX_GPIOB_PIN0_MODE_AF_OD
    default 5 if NX_GPIOB_PIN0_MODE_ANALOG

choice
    prompt "GPIOB PIN0 pull configuration"
    default NX_GPIOB_PIN0_PULL_NONE
    depends on INSTANCE_NX_GPIOB_PIN0

config NX_GPIOB_PIN0_PULL_NONE
    bool "No pull-up/pull-down"

config NX_GPIOB_PIN0_PULL_UP
    bool "Pull-up"

config NX_GPIOB_PIN0_PULL_DOWN
    bool "Pull-down"

endchoice

config GPIOB_PIN0_PULL_VALUE
    int
    default 0 if NX_GPIOB_PIN0_PULL_NONE
    default 1 if NX_GPIOB_PIN0_PULL_UP
    default 2 if NX_GPIOB_PIN0_PULL_DOWN

choice
    prompt "GPIOB PIN0 speed"
    default NX_GPIOB_PIN0_SPEED_MEDIUM
    depends on INSTANCE_NX_GPIOB_PIN0

config NX_GPIOB_PIN0_SPEED_LOW
    bool "Low speed"

config NX_GPIOB_PIN0_SPEED_MEDIUM
    bool "Medium speed"

config NX_GPIOB_PIN0_SPEED_HIGH
    bool "High speed"

config NX_GPIOB_PIN0_SPEED_VERY_HIGH
    bool "Very high speed"

endchoice

config GPIOB_PIN0_SPEED_VALUE
    int
    default 0 if NX_GPIOB_PIN0_SPEED_LOW
    default 1 if NX_GPIOB_PIN0_SPEED_MEDIUM
    default 2 if NX_GPIOB_PIN0_SPEED_HIGH
    default 3 if NX_GPIOB_PIN0_SPEED_VERY_HIGH

config GPIOB_PIN0_OUTPUT_VALUE
    int "GPIOB PIN0 initial output value"
    default 0
    range 0 1
    help
      Initial output value for GPIOB PIN0:
      0 = Low, 1 = High

endif # INSTANCE_NX_GPIOB_PIN0

endif # INSTANCE_NX_GPIOB

#GPIOC Configuration
menuconfig INSTANCE_NX_GPIOC
    bool "Enable GPIOC"
    default n
    depends on NATIVE_GPIO_ENABLE
    help
      Enable GPIO port C.

if INSTANCE_NX_GPIOC

menuconfig INSTANCE_NX_GPIOC_PIN0
    bool "Enable GPIOC PIN0"
    default y
    help
      Enable GPIOC pin 0.

if INSTANCE_NX_GPIOC_PIN0

choice
    prompt "GPIOC PIN0 mode"
    default NX_GPIOC_PIN0_MODE_OUTPUT_PP
    depends on INSTANCE_NX_GPIOC_PIN0

config NX_GPIOC_PIN0_MODE_INPUT
    bool "Input"

config NX_GPIOC_PIN0_MODE_OUTPUT_PP
    bool "Output Push-Pull"

config NX_GPIOC_PIN0_MODE_OUTPUT_OD
    bool "Output Open-Drain"

config NX_GPIOC_PIN0_MODE_AF_PP
    bool "Alternate Function Push-Pull"

config NX_GPIOC_PIN0_MODE_AF_OD
    bool "Alternate Function Open-Drain"

config NX_GPIOC_PIN0_MODE_ANALOG
    bool "Analog"

endchoice

config GPIOC_PIN0_MODE
    int
    default 0 if NX_GPIOC_PIN0_MODE_INPUT
    default 1 if NX_GPIOC_PIN0_MODE_OUTPUT_PP
    default 2 if NX_GPIOC_PIN0_MODE_OUTPUT_OD
    default 3 if NX_GPIOC_PIN0_MODE_AF_PP
    default 4 if NX_GPIOC_PIN0_MODE_AF_OD
    default 5 if NX_GPIOC_PIN0_MODE_ANALOG

choice
    prompt "GPIOC PIN0 pull configuration"
    default NX_GPIOC_PIN0_PULL_NONE
    depends on INSTANCE_NX_GPIOC_PIN0

config NX_GPIOC_PIN0_PULL_NONE
    bool "No pull-up/pull-down"

config NX_GPIOC_PIN0_PULL_UP
    bool "Pull-up"

config NX_GPIOC_PIN0_PULL_DOWN
    bool "Pull-down"

endchoice

config GPIOC_PIN0_PULL_VALUE
    int
    default 0 if NX_GPIOC_PIN0_PULL_NONE
    default 1 if NX_GPIOC_PIN0_PULL_UP
    default 2 if NX_GPIOC_PIN0_PULL_DOWN

choice
    prompt "GPIOC PIN0 speed"
    default NX_GPIOC_PIN0_SPEED_MEDIUM
    depends on INSTANCE_NX_GPIOC_PIN0

config NX_GPIOC_PIN0_SPEED_LOW
    bool "Low speed"

config NX_GPIOC_PIN0_SPEED_MEDIUM
    bool "Medium speed"

config NX_GPIOC_PIN0_SPEED_HIGH
    bool "High speed"

config NX_GPIOC_PIN0_SPEED_VERY_HIGH
    bool "Very high speed"

endchoice

config GPIOC_PIN0_SPEED_VALUE
    int
    default 0 if NX_GPIOC_PIN0_SPEED_LOW
    default 1 if NX_GPIOC_PIN0_SPEED_MEDIUM
    default 2 if NX_GPIOC_PIN0_SPEED_HIGH
    default 3 if NX_GPIOC_PIN0_SPEED_VERY_HIGH

config GPIOC_PIN0_OUTPUT_VALUE
    int "GPIOC PIN0 initial output value"
    default 0
    range 0 1
    help
      Initial output value for GPIOC PIN0:
      0 = Low, 1 = High

endif # INSTANCE_NX_GPIOC_PIN0

endif # INSTANCE_NX_GPIOC

endif # NATIVE_GPIO_ENABLE
```
