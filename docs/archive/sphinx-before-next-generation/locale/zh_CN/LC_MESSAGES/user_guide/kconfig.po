## platforms/native/src/adc/Kconfig
```kconfig
#ADC Configuration for Native Platform

config NATIVE_ADC_ENABLE
    bool "Enable ADC support for Native platform"
    default y
    depends on PLATFORM_NATIVE
    help
      Enable ADC peripheral support for the Native platform.
      This provides simulated ADC functionality for testing
      and development on PC.

if NATIVE_ADC_ENABLE

#ADC0 Configuration
menuconfig INSTANCE_NX_ADC_0
    bool "Enable ADC0"
    default y
    depends on NATIVE_ADC_ENABLE
    help
      Enable ADC instance 0.

if INSTANCE_NX_ADC_0

config ADC0_CHANNEL_COUNT
    int "ADC0 channel count"
    default 16
    range 1 16
    help
      Number of ADC channels for ADC0.

choice
    prompt "ADC0 resolution"
    default NX_ADC0_RESOLUTION_12
    depends on INSTANCE_NX_ADC_0

config NX_ADC0_RESOLUTION_8
    bool "8-bit resolution"

config NX_ADC0_RESOLUTION_10
    bool "10-bit resolution"

config NX_ADC0_RESOLUTION_12
    bool "12-bit resolution"

config NX_ADC0_RESOLUTION_16
    bool "16-bit resolution"

endchoice

config ADC0_RESOLUTION_VALUE
    int
    default 0 if NX_ADC0_RESOLUTION_8
    default 1 if NX_ADC0_RESOLUTION_10
    default 2 if NX_ADC0_RESOLUTION_12
    default 3 if NX_ADC0_RESOLUTION_16

config ADC0_RESOLUTION
    int
    default 8 if NX_ADC0_RESOLUTION_8
    default 10 if NX_ADC0_RESOLUTION_10
    default 12 if NX_ADC0_RESOLUTION_12
    default 16 if NX_ADC0_RESOLUTION_16

choice
    prompt "ADC0 sampling time"
    default NX_ADC0_SAMPLE_TIME_MEDIUM
    depends on INSTANCE_NX_ADC_0

config NX_ADC0_SAMPLE_TIME_FAST
    bool "Fast (1.5 cycles)"

config NX_ADC0_SAMPLE_TIME_MEDIUM
    bool "Medium (7.5 cycles)"

config NX_ADC0_SAMPLE_TIME_SLOW
    bool "Slow (28.5 cycles)"

endchoice

config ADC0_SAMPLE_TIME_VALUE
    int
    default 0 if NX_ADC0_SAMPLE_TIME_FAST
    default 1 if NX_ADC0_SAMPLE_TIME_MEDIUM
    default 2 if NX_ADC0_SAMPLE_TIME_SLOW

endif # INSTANCE_NX_ADC_0

#ADC1 Configuration
menuconfig INSTANCE_NX_ADC_1
    bool "Enable ADC1"
    default n
    depends on NATIVE_ADC_ENABLE
    help
      Enable ADC instance 1.

if INSTANCE_NX_ADC_1

config ADC1_CHANNEL_COUNT
    int "ADC1 channel count"
    default 16
    range 1 16
    help
      Number of ADC channels for ADC1.

choice
    prompt "ADC1 resolution"
    default NX_ADC1_RESOLUTION_BIT_12
    depends on INSTANCE_NX_ADC_1

config NX_ADC1_RESOLUTION_BIT_8
    bool "8-bit resolution"

config NX_ADC1_RESOLUTION_BIT_10
    bool "10-bit resolution"

config NX_ADC1_RESOLUTION_BIT_12
    bool "12-bit resolution"

config NX_ADC1_RESOLUTION_BIT_16
    bool "16-bit resolution"

endchoice

config ADC1_RESOLUTION_VALUE
    int
    default 0 if NX_ADC1_RESOLUTION_BIT_8
    default 1 if NX_ADC1_RESOLUTION_BIT_10
    default 2 if NX_ADC1_RESOLUTION_BIT_12
    default 3 if NX_ADC1_RESOLUTION_BIT_16

config ADC1_RESOLUTION
    int
    default 8 if NX_ADC1_RESOLUTION_BIT_8
    default 10 if NX_ADC1_RESOLUTION_BIT_10
    default 12 if NX_ADC1_RESOLUTION_BIT_12
    default 16 if NX_ADC1_RESOLUTION_BIT_16

choice
    prompt "ADC1 sampling time"
    default NX_ADC1_SAMPLE_TIME_MEDIUM
    depends on INSTANCE_NX_ADC_1

config NX_ADC1_SAMPLE_TIME_FAST
    bool "Fast (1.5 cycles)"

config NX_ADC1_SAMPLE_TIME_MEDIUM
    bool "Medium (7.5 cycles)"

config NX_ADC1_SAMPLE_TIME_SLOW
    bool "Slow (28.5 cycles)"

endchoice

config ADC1_SAMPLE_TIME_VALUE
    int
    default 0 if NX_ADC1_SAMPLE_TIME_FAST
    default 1 if NX_ADC1_SAMPLE_TIME_MEDIUM
    default 2 if NX_ADC1_SAMPLE_TIME_SLOW

endif # INSTANCE_NX_ADC_1

#ADC2 Configuration
menuconfig INSTANCE_NX_ADC_2
    bool "Enable ADC2"
    default n
    depends on NATIVE_ADC_ENABLE
    help
      Enable ADC instance 2.

if INSTANCE_NX_ADC_2

config ADC2_CHANNEL_COUNT
    int "ADC2 channel count"
    default 16
    range 1 16
    help
      Number of ADC channels for ADC2.

choice
    prompt "ADC2 resolution"
    default NX_ADC2_RESOLUTION_BIT_12
    depends on INSTANCE_NX_ADC_2

config NX_ADC2_RESOLUTION_BIT_8
    bool "8-bit resolution"

config NX_ADC2_RESOLUTION_BIT_10
    bool "10-bit resolution"

config NX_ADC2_RESOLUTION_BIT_12
    bool "12-bit resolution"

config NX_ADC2_RESOLUTION_BIT_16
    bool "16-bit resolution"

endchoice

config ADC2_RESOLUTION_VALUE
    int
    default 0 if NX_ADC2_RESOLUTION_BIT_8
    default 1 if NX_ADC2_RESOLUTION_BIT_10
    default 2 if NX_ADC2_RESOLUTION_BIT_12
    default 3 if NX_ADC2_RESOLUTION_BIT_16

config ADC2_RESOLUTION
    int
    default 8 if NX_ADC2_RESOLUTION_BIT_8
    default 10 if NX_ADC2_RESOLUTION_BIT_10
    default 12 if NX_ADC2_RESOLUTION_BIT_12
    default 16 if NX_ADC2_RESOLUTION_BIT_16

choice
    prompt "ADC2 sampling time"
    default NX_ADC2_SAMPLE_TIME_MEDIUM
    depends on INSTANCE_NX_ADC_2

config NX_ADC2_SAMPLE_TIME_FAST
    bool "Fast (1.5 cycles)"

config NX_ADC2_SAMPLE_TIME_MEDIUM
    bool "Medium (7.5 cycles)"

config NX_ADC2_SAMPLE_TIME_SLOW
    bool "Slow (28.5 cycles)"

endchoice

config ADC2_SAMPLE_TIME_VALUE
    int
    default 0 if NX_ADC2_SAMPLE_TIME_FAST
    default 1 if NX_ADC2_SAMPLE_TIME_MEDIUM
    default 2 if NX_ADC2_SAMPLE_TIME_SLOW

endif # INSTANCE_NX_ADC_2

#ADC3 Configuration
menuconfig INSTANCE_NX_ADC_3
    bool "Enable ADC3"
    default n
    depends on NATIVE_ADC_ENABLE
    help
      Enable ADC instance 3.

if INSTANCE_NX_ADC_3

config ADC3_CHANNEL_COUNT
    int "ADC3 channel count"
    default 16
    range 1 16
    help
      Number of ADC channels for ADC3.

choice
    prompt "ADC3 resolution"
    default NX_ADC3_RESOLUTION_BIT_12
    depends on INSTANCE_NX_ADC_3

config NX_ADC3_RESOLUTION_BIT_8
    bool "8-bit resolution"

config NX_ADC3_RESOLUTION_BIT_10
    bool "10-bit resolution"

config NX_ADC3_RESOLUTION_BIT_12
    bool "12-bit resolution"

config NX_ADC3_RESOLUTION_BIT_16
    bool "16-bit resolution"

endchoice

config ADC3_RESOLUTION_VALUE
    int
    default 0 if NX_ADC3_RESOLUTION_BIT_8
    default 1 if NX_ADC3_RESOLUTION_BIT_10
    default 2 if NX_ADC3_RESOLUTION_BIT_12
    default 3 if NX_ADC3_RESOLUTION_BIT_16

config ADC3_RESOLUTION
    int
    default 8 if NX_ADC3_RESOLUTION_BIT_8
    default 10 if NX_ADC3_RESOLUTION_BIT_10
    default 12 if NX_ADC3_RESOLUTION_BIT_12
    default 16 if NX_ADC3_RESOLUTION_BIT_16

choice
    prompt "ADC3 sampling time"
    default NX_ADC3_SAMPLE_TIME_MEDIUM
    depends on INSTANCE_NX_ADC_3

config NX_ADC3_SAMPLE_TIME_FAST
    bool "Fast (1.5 cycles)"

config NX_ADC3_SAMPLE_TIME_MEDIUM
    bool "Medium (7.5 cycles)"

config NX_ADC3_SAMPLE_TIME_SLOW
    bool "Slow (28.5 cycles)"

endchoice

config ADC3_SAMPLE_TIME_VALUE
    int
    default 0 if NX_ADC3_SAMPLE_TIME_FAST
    default 1 if NX_ADC3_SAMPLE_TIME_MEDIUM
    default 2 if NX_ADC3_SAMPLE_TIME_SLOW

endif # INSTANCE_NX_ADC_3

endif # NATIVE_ADC_ENABLE

#ADC Buffer Configuration
config NATIVE_ADC_BUFFER_ENABLE
    bool "Enable ADC Buffer support for Native platform"
    default y
    depends on PLATFORM_NATIVE && NATIVE_ADC_ENABLE
    help
      Enable ADC Buffer peripheral support for the Native platform.
      This provides simulated buffered multi-channel ADC sampling
      for testing and development on PC.

if NATIVE_ADC_BUFFER_ENABLE

#ADC Buffer 0 Configuration
menuconfig INSTANCE_NX_ADC_BUFFER_0
    bool "Enable ADC_BUFFER0"
    default y
    depends on NATIVE_ADC_BUFFER_ENABLE
    help
      Enable ADC Buffer instance 0.

if INSTANCE_NX_ADC_BUFFER_0

config ADC_BUFFER0_CHANNEL_COUNT
    int "ADC_BUFFER0 channel count"
    default 4
    range 1 16
    help
      Number of ADC channels for ADC_BUFFER0.

config ADC_BUFFER0_BUFFER_SIZE
    int "ADC_BUFFER0 buffer size (samples)"
    default 256
    range 16 4096
    help
      Buffer size for ADC_BUFFER0 in samples.
      Will be aligned to multiple of channel count.

choice
    prompt "ADC_BUFFER0 trigger mode"
    default NX_ADC_BUFFER0_TRIGGER_SOFTWARE
    depends on INSTANCE_NX_ADC_BUFFER_0

config NX_ADC_BUFFER0_TRIGGER_SOFTWARE
    bool "Software trigger"

config NX_ADC_BUFFER0_TRIGGER_TIMER
    bool "Timer trigger"

config NX_ADC_BUFFER0_TRIGGER_EXTERNAL
    bool "External trigger"

endchoice

config ADC_BUFFER0_TRIGGER_VALUE
    int
    default 0 if NX_ADC_BUFFER0_TRIGGER_SOFTWARE
    default 1 if NX_ADC_BUFFER0_TRIGGER_TIMER
    default 2 if NX_ADC_BUFFER0_TRIGGER_EXTERNAL

endif # INSTANCE_NX_ADC_BUFFER_0

#ADC Buffer 1 Configuration
menuconfig INSTANCE_NX_ADC_BUFFER_1
    bool "Enable ADC_BUFFER1"
    default n
    depends on NATIVE_ADC_BUFFER_ENABLE
    help
      Enable ADC Buffer instance 1.

if INSTANCE_NX_ADC_BUFFER_1

config ADC_BUFFER1_CHANNEL_COUNT
    int "ADC_BUFFER1 channel count"
    default 4
    range 1 16
    help
      Number of ADC channels for ADC_BUFFER1.

config ADC_BUFFER1_BUFFER_SIZE
    int "ADC_BUFFER1 buffer size (samples)"
    default 256
    range 16 4096
    help
      Buffer size for ADC_BUFFER1 in samples.
      Will be aligned to multiple of channel count.

choice
    prompt "ADC_BUFFER1 trigger mode"
    default NX_ADC_BUFFER1_TRIGGER_SOFTWARE
    depends on INSTANCE_NX_ADC_BUFFER_1

config NX_ADC_BUFFER1_TRIGGER_SOFTWARE
    bool "Software trigger"

config NX_ADC_BUFFER1_TRIGGER_TIMER
    bool "Timer trigger"

config NX_ADC_BUFFER1_TRIGGER_EXTERNAL
    bool "External trigger"

endchoice

config ADC_BUFFER1_TRIGGER_VALUE
    int
    default 0 if NX_ADC_BUFFER1_TRIGGER_SOFTWARE
    default 1 if NX_ADC_BUFFER1_TRIGGER_TIMER
    default 2 if NX_ADC_BUFFER1_TRIGGER_EXTERNAL

endif # INSTANCE_NX_ADC_BUFFER_1

#ADC Buffer 2 Configuration
menuconfig INSTANCE_NX_ADC_BUFFER_2
    bool "Enable ADC_BUFFER2"
    default n
    depends on NATIVE_ADC_BUFFER_ENABLE
    help
      Enable ADC Buffer instance 2.

if INSTANCE_NX_ADC_BUFFER_2

config ADC_BUFFER2_CHANNEL_COUNT
    int "ADC_BUFFER2 channel count"
    default 4
    range 1 16
    help
      Number of ADC channels for ADC_BUFFER2.

config ADC_BUFFER2_BUFFER_SIZE
    int "ADC_BUFFER2 buffer size (samples)"
    default 256
    range 16 4096
    help
      Buffer size for ADC_BUFFER2 in samples.
      Will be aligned to multiple of channel count.

choice
    prompt "ADC_BUFFER2 trigger mode"
    default NX_ADC_BUFFER2_TRIGGER_SOFTWARE
    depends on INSTANCE_NX_ADC_BUFFER_2

config NX_ADC_BUFFER2_TRIGGER_SOFTWARE
    bool "Software trigger"

config NX_ADC_BUFFER2_TRIGGER_TIMER
    bool "Timer trigger"

config NX_ADC_BUFFER2_TRIGGER_EXTERNAL
    bool "External trigger"

endchoice

config ADC_BUFFER2_TRIGGER_VALUE
    int
    default 0 if NX_ADC_BUFFER2_TRIGGER_SOFTWARE
    default 1 if NX_ADC_BUFFER2_TRIGGER_TIMER
    default 2 if NX_ADC_BUFFER2_TRIGGER_EXTERNAL

endif # INSTANCE_NX_ADC_BUFFER_2

#ADC Buffer 3 Configuration
menuconfig INSTANCE_NX_ADC_BUFFER_3
    bool "Enable ADC_BUFFER3"
    default n
    depends on NATIVE_ADC_BUFFER_ENABLE
    help
      Enable ADC Buffer instance 3.

if INSTANCE_NX_ADC_BUFFER_3

config ADC_BUFFER3_CHANNEL_COUNT
    int "ADC_BUFFER3 channel count"
    default 4
    range 1 16
    help
      Number of ADC channels for ADC_BUFFER3.

config ADC_BUFFER3_BUFFER_SIZE
    int "ADC_BUFFER3 buffer size (samples)"
    default 256
    range 16 4096
    help
      Buffer size for ADC_BUFFER3 in samples.
      Will be aligned to multiple of channel count.

choice
    prompt "ADC_BUFFER3 trigger mode"
    default NX_ADC_BUFFER3_TRIGGER_SOFTWARE
    depends on INSTANCE_NX_ADC_BUFFER_3

config NX_ADC_BUFFER3_TRIGGER_SOFTWARE
    bool "Software trigger"

config NX_ADC_BUFFER3_TRIGGER_TIMER
    bool "Timer trigger"

config NX_ADC_BUFFER3_TRIGGER_EXTERNAL
    bool "External trigger"

endchoice

config ADC_BUFFER3_TRIGGER_VALUE
    int
    default 0 if NX_ADC_BUFFER3_TRIGGER_SOFTWARE
    default 1 if NX_ADC_BUFFER3_TRIGGER_TIMER
    default 2 if NX_ADC_BUFFER3_TRIGGER_EXTERNAL

endif # INSTANCE_NX_ADC_BUFFER_3

endif # NATIVE_ADC_BUFFER_ENABLE
```

## platforms/native/src/crc/Kconfig
```kconfig
# CRC Configuration for Native Platform

config CRC_NATIVE
    bool "Enable CRC support for Native platform"
    default y
    depends on PLATFORM_NATIVE
    help
      Enable CRC peripheral support for the Native platform.
      This provides simulated CRC functionality for testing
      and development on PC.

if CRC_NATIVE

config CRC_MAX_INSTANCES
    int "Maximum number of CRC instances"
    default 1
    range 1 4
    help
      Maximum number of CRC instances supported by the
      Native platform.

# CRC0 Configuration
config INSTANCE_NX_CRC0
    bool "Enable CRC0"
    default y
    help
      Enable CRC instance 0.

if INSTANCE_NX_CRC0

choice CRC0_ALGORITHM
    prompt "CRC0 algorithm"
    default CRC0_ALGORITHM_CRC32
    help
      Select the default CRC algorithm for CRC0.

config CRC0_ALGORITHM_CRC32
    bool "CRC-32 (IEEE 802.3)"
    help
      Use CRC-32 algorithm with polynomial 0x04C11DB7.

config CRC0_ALGORITHM_CRC16
    bool "CRC-16 (CCITT)"
    help
      Use CRC-16 CCITT algorithm with polynomial 0x1021.

endchoice

config CRC0_POLYNOMIAL
    hex "CRC0 polynomial"
    default 0x04C11DB7 if CRC0_ALGORITHM_CRC32
    default 0x1021 if CRC0_ALGORITHM_CRC16
    help
      CRC polynomial value for CRC0.
      Default: 0x04C11DB7 for CRC-32, 0x1021 for CRC-16.

config CRC0_INIT_VALUE
    hex "CRC0 initial value"
    default 0xFFFFFFFF if CRC0_ALGORITHM_CRC32
    default 0xFFFF if CRC0_ALGORITHM_CRC16
    help
      Initial CRC value for CRC0.
      Default: 0xFFFFFFFF for CRC-32, 0xFFFF for CRC-16.

config CRC0_FINAL_XOR
    hex "CRC0 final XOR value"
    default 0xFFFFFFFF if CRC0_ALGORITHM_CRC32
    default 0x0000 if CRC0_ALGORITHM_CRC16
    help
      Final XOR value applied to CRC result.
      Default: 0xFFFFFFFF for CRC-32, 0x0000 for CRC-16.

endif # INSTANCE_NX_CRC0

# CRC1 Configuration
config INSTANCE_NX_CRC1
    bool "Enable CRC1"
    default n
    help
      Enable CRC instance 1.

if INSTANCE_NX_CRC1

choice CRC1_ALGORITHM
    prompt "CRC1 algorithm"
    default CRC1_ALGORITHM_CRC32
    help
      Select the default CRC algorithm for CRC1.

config CRC1_ALGORITHM_CRC32
    bool "CRC-32 (IEEE 802.3)"
    help
      Use CRC-32 algorithm with polynomial 0x04C11DB7.

config CRC1_ALGORITHM_CRC16
    bool "CRC-16 (CCITT)"
    help
      Use CRC-16 CCITT algorithm with polynomial 0x1021.

endchoice

config CRC1_POLYNOMIAL
    hex "CRC1 polynomial"
    default 0x04C11DB7 if CRC1_ALGORITHM_CRC32
    default 0x1021 if CRC1_ALGORITHM_CRC16
    help
      CRC polynomial value for CRC1.

config CRC1_INIT_VALUE
    hex "CRC1 initial value"
    default 0xFFFFFFFF if CRC1_ALGORITHM_CRC32
    default 0xFFFF if CRC1_ALGORITHM_CRC16
    help
      Initial CRC value for CRC1.

config CRC1_FINAL_XOR
    hex "CRC1 final XOR value"
    default 0xFFFFFFFF if CRC1_ALGORITHM_CRC32
    default 0x0000 if CRC1_ALGORITHM_CRC16
    help
      Final XOR value applied to CRC result.

endif # INSTANCE_NX_CRC1

endif # CRC_NATIVE
```
