## platforms/native/src/i2c/Kconfig
```kconfig
# I2C Configuration for Native Platform

config NATIVE_I2C_ENABLE
    bool "Enable I2C support for Native platform"
    default y
    depends on PLATFORM_NATIVE
    help
      Enable I2C peripheral support for the Native platform.
      This provides simulated I2C functionality for testing
      and development on PC.

if NATIVE_I2C_ENABLE

# I2C0 Configuration
menuconfig INSTANCE_NX_I2C_0
    bool "Enable I2C0"
    default y
    depends on NATIVE_I2C_ENABLE
    help
      Enable I2C instance 0.

if INSTANCE_NX_I2C_0

choice
    prompt "I2C0 speed mode"
    default NX_I2C0_SPEED_STANDARD
    depends on INSTANCE_NX_I2C_0

config NX_I2C0_SPEED_STANDARD
    bool "Standard mode (100 kHz)"

config NX_I2C0_SPEED_FAST
    bool "Fast mode (400 kHz)"

config NX_I2C0_SPEED_FAST_PLUS
    bool "Fast mode plus (1 MHz)"

endchoice

config I2C0_SPEED_VALUE
    int
    default 0 if NX_I2C0_SPEED_STANDARD
    default 1 if NX_I2C0_SPEED_FAST
    default 2 if NX_I2C0_SPEED_FAST_PLUS

config I2C0_SPEED
    int
    default 100000 if NX_I2C0_SPEED_STANDARD
    default 400000 if NX_I2C0_SPEED_FAST
    default 1000000 if NX_I2C0_SPEED_FAST_PLUS

choice
    prompt "I2C0 addressing mode"
    default NX_I2C0_ADDR_BIT_7
    depends on INSTANCE_NX_I2C_0

config NX_I2C0_ADDR_BIT_7
    bool "7-bit addressing"

config NX_I2C0_ADDR_BIT_10
    bool "10-bit addressing"

endchoice

config I2C0_ADDR_VALUE
    int
    default 0 if NX_I2C0_ADDR_BIT_7
    default 1 if NX_I2C0_ADDR_BIT_10

config I2C0_ADDR_MODE_VALUE
    int
    default 0 if NX_I2C0_ADDR_BIT_7
    default 1 if NX_I2C0_ADDR_BIT_10

config I2C0_TX_BUFFER_SIZE
    int "I2C0 TX buffer size"
    default 256
    range 16 4096
    help
      Size of TX buffer for I2C0 in bytes.

config I2C0_RX_BUFFER_SIZE
    int "I2C0 RX buffer size"
    default 256
    range 16 4096
    help
      Size of RX buffer for I2C0 in bytes.

endif # INSTANCE_NX_I2C_0

# I2C1 Configuration
menuconfig INSTANCE_NX_I2C_1
    bool "Enable I2C1"
    default n
    depends on NATIVE_I2C_ENABLE
    help
      Enable I2C instance 1.

if INSTANCE_NX_I2C_1

choice
    prompt "I2C1 speed mode"
    default NX_I2C1_SPEED_STANDARD
    depends on INSTANCE_NX_I2C_1

config NX_I2C1_SPEED_STANDARD
    bool "Standard mode (100 kHz)"

config NX_I2C1_SPEED_FAST
    bool "Fast mode (400 kHz)"

config NX_I2C1_SPEED_FAST_PLUS
    bool "Fast mode plus (1 MHz)"

endchoice

config I2C1_SPEED_VALUE
    int
    default 0 if NX_I2C1_SPEED_STANDARD
    default 1 if NX_I2C1_SPEED_FAST
    default 2 if NX_I2C1_SPEED_FAST_PLUS

config I2C1_SPEED
    int
    default 100000 if NX_I2C1_SPEED_STANDARD
    default 400000 if NX_I2C1_SPEED_FAST
    default 1000000 if NX_I2C1_SPEED_FAST_PLUS

choice
    prompt "I2C1 addressing mode"
    default NX_I2C1_ADDR_BIT_7
    depends on INSTANCE_NX_I2C_1

config NX_I2C1_ADDR_BIT_7
    bool "7-bit addressing"

config NX_I2C1_ADDR_BIT_10
    bool "10-bit addressing"

endchoice

config I2C1_ADDR_VALUE
    int
    default 0 if NX_I2C1_ADDR_BIT_7
    default 1 if NX_I2C1_ADDR_BIT_10

config I2C1_ADDR_MODE_VALUE
    int
    default 0 if NX_I2C1_ADDR_BIT_7
    default 1 if NX_I2C1_ADDR_BIT_10

config I2C1_TX_BUFFER_SIZE
    int "I2C1 TX buffer size"
    default 256
    range 16 4096
    help
      Size of TX buffer for I2C1 in bytes.

config I2C1_RX_BUFFER_SIZE
    int "I2C1 RX buffer size"
    default 256
    range 16 4096
    help
      Size of RX buffer for I2C1 in bytes.

endif # INSTANCE_NX_I2C_1

# I2C2 Configuration
menuconfig INSTANCE_NX_I2C_2
    bool "Enable I2C2"
    default n
    depends on NATIVE_I2C_ENABLE
    help
      Enable I2C instance 2.

if INSTANCE_NX_I2C_2

choice
    prompt "I2C2 speed mode"
    default NX_I2C2_SPEED_STANDARD
    depends on INSTANCE_NX_I2C_2

config NX_I2C2_SPEED_STANDARD
    bool "Standard mode (100 kHz)"

config NX_I2C2_SPEED_FAST
    bool "Fast mode (400 kHz)"

config NX_I2C2_SPEED_FAST_PLUS
    bool "Fast mode plus (1 MHz)"

endchoice

config I2C2_SPEED_VALUE
    int
    default 0 if NX_I2C2_SPEED_STANDARD
    default 1 if NX_I2C2_SPEED_FAST
    default 2 if NX_I2C2_SPEED_FAST_PLUS

config I2C2_SPEED
    int
    default 100000 if NX_I2C2_SPEED_STANDARD
    default 400000 if NX_I2C2_SPEED_FAST
    default 1000000 if NX_I2C2_SPEED_FAST_PLUS

choice
    prompt "I2C2 addressing mode"
    default NX_I2C2_ADDR_BIT_7
    depends on INSTANCE_NX_I2C_2

config NX_I2C2_ADDR_BIT_7
    bool "7-bit addressing"

config NX_I2C2_ADDR_BIT_10
    bool "10-bit addressing"

endchoice

config I2C2_ADDR_VALUE
    int
    default 0 if NX_I2C2_ADDR_BIT_7
    default 1 if NX_I2C2_ADDR_BIT_10

config I2C2_ADDR_MODE_VALUE
    int
    default 0 if NX_I2C2_ADDR_BIT_7
    default 1 if NX_I2C2_ADDR_BIT_10

config I2C2_TX_BUFFER_SIZE
    int "I2C2 TX buffer size"
    default 256
    range 16 4096
    help
      Size of TX buffer for I2C2 in bytes.

config I2C2_RX_BUFFER_SIZE
    int "I2C2 RX buffer size"
    default 256
    range 16 4096
    help
      Size of RX buffer for I2C2 in bytes.

endif # INSTANCE_NX_I2C_2

# I2C3 Configuration
menuconfig INSTANCE_NX_I2C_3
    bool "Enable I2C3"
    default n
    depends on NATIVE_I2C_ENABLE
    help
      Enable I2C instance 3.

if INSTANCE_NX_I2C_3

choice
    prompt "I2C3 speed mode"
    default NX_I2C3_SPEED_STANDARD
    depends on INSTANCE_NX_I2C_3

config NX_I2C3_SPEED_STANDARD
    bool "Standard mode (100 kHz)"

config NX_I2C3_SPEED_FAST
    bool "Fast mode (400 kHz)"

config NX_I2C3_SPEED_FAST_PLUS
    bool "Fast mode plus (1 MHz)"

endchoice

config I2C3_SPEED_VALUE
    int
    default 0 if NX_I2C3_SPEED_STANDARD
    default 1 if NX_I2C3_SPEED_FAST
    default 2 if NX_I2C3_SPEED_FAST_PLUS

config I2C3_SPEED
    int
    default 100000 if NX_I2C3_SPEED_STANDARD
    default 400000 if NX_I2C3_SPEED_FAST
    default 1000000 if NX_I2C3_SPEED_FAST_PLUS

choice
    prompt "I2C3 addressing mode"
    default NX_I2C3_ADDR_BIT_7
    depends on INSTANCE_NX_I2C_3

config NX_I2C3_ADDR_BIT_7
    bool "7-bit addressing"

config NX_I2C3_ADDR_BIT_10
    bool "10-bit addressing"

endchoice

config I2C3_ADDR_VALUE
    int
    default 0 if NX_I2C3_ADDR_BIT_7
    default 1 if NX_I2C3_ADDR_BIT_10

config I2C3_ADDR_MODE_VALUE
    int
    default 0 if NX_I2C3_ADDR_BIT_7
    default 1 if NX_I2C3_ADDR_BIT_10

config I2C3_TX_BUFFER_SIZE
    int "I2C3 TX buffer size"
    default 256
    range 16 4096
    help
      Size of TX buffer for I2C3 in bytes.

config I2C3_RX_BUFFER_SIZE
    int "I2C3 RX buffer size"
    default 256
    range 16 4096
    help
      Size of RX buffer for I2C3 in bytes.

endif # INSTANCE_NX_I2C_3

endif # NATIVE_I2C_ENABLE
```

## platforms/native/src/option_bytes/Kconfig
```kconfig
config NATIVE_OPTION_BYTES
    bool "Enable Option Bytes support"
    default y
    help
      Enable Option Bytes peripheral support for Native platform.
      Provides simulated device configuration options with read/write protection.

if NATIVE_OPTION_BYTES

config NATIVE_OPTION_BYTES_INSTANCES
    int "Number of Option Bytes instances"
    default 1
    range 1 4
    help
      Number of Option Bytes peripheral instances to create.

config NATIVE_OPTION_BYTES_USER_DATA_SIZE
    int "User data size in bytes"
    default 16
    help
      Size of user data area in option bytes.

config NATIVE_OPTION_BYTES_DEFAULT_PROTECTION
    int "Default read protection level"
    default 0
    range 0 2
    help
      Default read protection level (0=none, 1=level1, 2=level2).

endif # NATIVE_OPTION_BYTES
```

## platforms/native/src/rtc/Kconfig
```kconfig
#RTC Configuration for Native Platform

config NATIVE_RTC_ENABLE
    bool "Enable RTC support for Native platform"
    default y
    depends on PLATFORM_NATIVE
    help
      Enable RTC (Real-Time Clock) peripheral support for the
      Native platform. This provides simulated RTC functionality
      for testing and development on PC.

if NATIVE_RTC_ENABLE

#RTC0 Configuration
menuconfig INSTANCE_NX_RTC_0
    bool "Enable RTC0"
    default y
    depends on NATIVE_RTC_ENABLE
    help
      Enable RTC instance 0.

if INSTANCE_NX_RTC_0

config RTC0_ENABLE_ALARM
    bool "Enable alarm functionality for RTC0"
    default y
    help
      Enable alarm functionality for RTC0.

config RTC0_ALARM_COUNT
    int "Number of alarms for RTC0"
    default 2
    range 1 4
    depends on RTC0_ENABLE_ALARM
    help
      Number of alarm channels for RTC0.

choice
    prompt "RTC0 clock source"
    default NX_RTC0_CLOCK_LSE
    depends on INSTANCE_NX_RTC0

config NX_RTC0_CLOCK_LSE
    bool "LSE (Low Speed External)"
    help
      Use external 32.768 kHz crystal.

config NX_RTC0_CLOCK_LSI
    bool "LSI (Low Speed Internal)"
    help
      Use internal low speed oscillator.

config NX_RTC0_CLOCK_HSE
    bool "HSE (High Speed External)"
    help
      Use high speed external clock divided.

endchoice

config RTC0_CLOCK_VALUE
    int
    default 0 if NX_RTC0_CLOCK_LSE
    default 1 if NX_RTC0_CLOCK_LSI
    default 2 if NX_RTC0_CLOCK_HSE

config RTC0_CLOCK_SOURCE_VALUE
    int
    default 0 if NX_RTC0_CLOCK_LSE
    default 1 if NX_RTC0_CLOCK_LSI
    default 2 if NX_RTC0_CLOCK_HSE

choice
    prompt "RTC0 output format"
    default NX_RTC0_FORMAT_H_24
    depends on INSTANCE_NX_RTC0

config NX_RTC0_FORMAT_H_24
    bool "24-hour format"

config NX_RTC0_FORMAT_H_12
    bool "12-hour format (AM/PM)"

endchoice

config RTC0_FORMAT_VALUE
    int
    default 0 if NX_RTC0_FORMAT_H_24
    default 1 if NX_RTC0_FORMAT_H_12
    default 0 if NX_RTC0_FORMAT_24H
    default 1 if NX_RTC0_FORMAT_12H

endif # INSTANCE_NX_RTC0

#RTC1 Configuration
menuconfig INSTANCE_NX_RTC1
    bool "Enable RTC1"
    default n
    depends on NATIVE_RTC_ENABLE
    help
      Enable RTC instance 1.

if INSTANCE_NX_RTC1

config RTC1_ENABLE_ALARM
    bool "Enable alarm functionality for RTC1"
    default y
    help
      Enable alarm functionality for RTC1.

config RTC1_ALARM_COUNT
    int "Number of alarms for RTC1"
    default 2
    range 1 4
    depends on RTC1_ENABLE_ALARM
    help
      Number of alarm channels for RTC1.

choice
    prompt "RTC1 clock source"
    default NX_RTC1_CLOCK_LSE
    depends on INSTANCE_NX_RTC1

config NX_RTC1_CLOCK_LSE
    bool "LSE (Low Speed External)"
    help
      Use external 32.768 kHz crystal.

config NX_RTC1_CLOCK_LSI
    bool "LSI (Low Speed Internal)"
    help
      Use internal low speed oscillator.

config NX_RTC1_CLOCK_HSE
    bool "HSE (High Speed External)"
    help
      Use high speed external clock divided.

endchoice

config RTC1_CLOCK_VALUE
    int
    default 0 if NX_RTC1_CLOCK_LSE
    default 1 if NX_RTC1_CLOCK_LSI
    default 2 if NX_RTC1_CLOCK_HSE

config RTC1_CLOCK_SOURCE_VALUE
    int
    default 0 if NX_RTC1_CLOCK_LSE
    default 1 if NX_RTC1_CLOCK_LSI
    default 2 if NX_RTC1_CLOCK_HSE

choice
    prompt "RTC1 output format"
    default NX_RTC1_FORMAT_H_24
    depends on INSTANCE_NX_RTC1

config NX_RTC1_FORMAT_H_24
    bool "24-hour format"

config NX_RTC1_FORMAT_H_12
    bool "12-hour format (AM/PM)"

endchoice

config RTC1_FORMAT_VALUE
    int
    default 0 if NX_RTC1_FORMAT_H_24
    default 1 if NX_RTC1_FORMAT_H_12
    default 0 if NX_RTC1_FORMAT_24H
    default 1 if NX_RTC1_FORMAT_12H

endif # INSTANCE_NX_RTC1

endif # NATIVE_RTC_ENABLE
```

## platforms/native/src/sdio/Kconfig
```kconfig
config NATIVE_SDIO
    bool "Enable SDIO support"
    default y
    help
      Enable SDIO peripheral support for Native platform.

if NATIVE_SDIO

config NATIVE_SDIO_INSTANCES
    int "Number of SDIO instances"
    default 1
    range 1 4
    help
      Number of SDIO instances to support.

config NATIVE_SDIO_CARD_PRESENT
    bool "Simulate card present at startup"
    default y
    help
      Simulate SD card present at startup for testing.

config NATIVE_SDIO_BLOCK_SIZE
    int "SDIO block size"
    default 512
    help
      SDIO block size in bytes (standard is 512).

config NATIVE_SDIO_NUM_BLOCKS
    int "Number of SDIO blocks"
    default 1024
    help
      Number of blocks in simulated SD card (default 1024 = 512KB).

endif # NATIVE_SDIO
```
