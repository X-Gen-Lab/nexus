## platforms/native/src/dac/Kconfig
```kconfig
# DAC Configuration for Native Platform

config NATIVE_DAC_ENABLE
    bool "Enable DAC support for Native platform"
    default y
    depends on PLATFORM_NATIVE
    help
      Enable DAC peripheral support for the Native platform.
      This provides simulated DAC functionality for testing
      and development on PC.

if NATIVE_DAC_ENABLE

# DAC0 Configuration
menuconfig INSTANCE_NX_DAC_0
    bool "Enable DAC0"
    default y
    depends on NATIVE_DAC_ENABLE
    help
      Enable DAC instance 0.

if INSTANCE_NX_DAC_0

config DAC0_CHANNEL_COUNT
    int "DAC0 channel count"
    default 2
    range 1 4
    help
      Number of DAC channels for DAC0.

choice
    prompt "DAC0 resolution"
    default NX_DAC0_RESOLUTION_BIT_12
    depends on INSTANCE_NX_DAC_0

config NX_DAC0_RESOLUTION_BIT_8
    bool "8-bit resolution"

config NX_DAC0_RESOLUTION_BIT_10
    bool "10-bit resolution"

config NX_DAC0_RESOLUTION_BIT_12
    bool "12-bit resolution"

config NX_DAC0_RESOLUTION_BIT_16
    bool "16-bit resolution"

endchoice

config DAC0_RESOLUTION_VALUE
    int
    default 0 if NX_DAC0_RESOLUTION_BIT_8
    default 1 if NX_DAC0_RESOLUTION_BIT_10
    default 2 if NX_DAC0_RESOLUTION_BIT_12
    default 3 if NX_DAC0_RESOLUTION_BIT_16

config DAC0_RESOLUTION
    int
    default 8 if NX_DAC0_RESOLUTION_BIT_8
    default 10 if NX_DAC0_RESOLUTION_BIT_10
    default 12 if NX_DAC0_RESOLUTION_BIT_12
    default 16 if NX_DAC0_RESOLUTION_BIT_16

config DAC0_VREF_MV
    int "DAC0 reference voltage (mV)"
    default 3300
    range 1000 5000
    help
      Reference voltage for DAC0 in millivolts.

choice
    prompt "DAC0 trigger mode"
    default NX_DAC0_TRIGGER_SOFTWARE
    depends on INSTANCE_NX_DAC_0

config NX_DAC0_TRIGGER_SOFTWARE
    bool "Software trigger"

config NX_DAC0_TRIGGER_TIMER
    bool "Timer trigger"

config NX_DAC0_TRIGGER_EXTERNAL
    bool "External trigger"

endchoice

config DAC0_TRIGGER_VALUE
    int
    default 0 if NX_DAC0_TRIGGER_SOFTWARE
    default 1 if NX_DAC0_TRIGGER_TIMER
    default 2 if NX_DAC0_TRIGGER_EXTERNAL

endif # INSTANCE_NX_DAC_0

# DAC1 Configuration
menuconfig INSTANCE_NX_DAC_1
    bool "Enable DAC1"
    default n
    depends on NATIVE_DAC_ENABLE
    help
      Enable DAC instance 1.

if INSTANCE_NX_DAC_1

config DAC1_CHANNEL_COUNT
    int "DAC1 channel count"
    default 2
    range 1 4
    help
      Number of DAC channels for DAC1.

choice
    prompt "DAC1 resolution"
    default NX_DAC1_RESOLUTION_BIT_12
    depends on INSTANCE_NX_DAC_1

config NX_DAC1_RESOLUTION_BIT_8
    bool "8-bit resolution"

config NX_DAC1_RESOLUTION_BIT_10
    bool "10-bit resolution"

config NX_DAC1_RESOLUTION_BIT_12
    bool "12-bit resolution"

config NX_DAC1_RESOLUTION_BIT_16
    bool "16-bit resolution"

endchoice

config DAC1_RESOLUTION_VALUE
    int
    default 0 if NX_DAC1_RESOLUTION_BIT_8
    default 1 if NX_DAC1_RESOLUTION_BIT_10
    default 2 if NX_DAC1_RESOLUTION_BIT_12
    default 3 if NX_DAC1_RESOLUTION_BIT_16

config DAC1_RESOLUTION
    int
    default 8 if NX_DAC1_RESOLUTION_BIT_8
    default 10 if NX_DAC1_RESOLUTION_BIT_10
    default 12 if NX_DAC1_RESOLUTION_BIT_12
    default 16 if NX_DAC1_RESOLUTION_BIT_16

config DAC1_VREF_MV
    int "DAC1 reference voltage (mV)"
    default 3300
    range 1000 5000
    help
      Reference voltage for DAC1 in millivolts.

choice
    prompt "DAC1 trigger mode"
    default NX_DAC1_TRIGGER_SOFTWARE
    depends on INSTANCE_NX_DAC_1

config NX_DAC1_TRIGGER_SOFTWARE
    bool "Software trigger"

config NX_DAC1_TRIGGER_TIMER
    bool "Timer trigger"

config NX_DAC1_TRIGGER_EXTERNAL
    bool "External trigger"

endchoice

config DAC1_TRIGGER_VALUE
    int
    default 0 if NX_DAC1_TRIGGER_SOFTWARE
    default 1 if NX_DAC1_TRIGGER_TIMER
    default 2 if NX_DAC1_TRIGGER_EXTERNAL

endif # INSTANCE_NX_DAC_1

# DAC2 Configuration
menuconfig INSTANCE_NX_DAC_2
    bool "Enable DAC2"
    default n
    depends on NATIVE_DAC_ENABLE
    help
      Enable DAC instance 2.

if INSTANCE_NX_DAC_2

config DAC2_CHANNEL_COUNT
    int "DAC2 channel count"
    default 2
    range 1 4
    help
      Number of DAC channels for DAC2.

choice
    prompt "DAC2 resolution"
    default NX_DAC2_RESOLUTION_BIT_12
    depends on INSTANCE_NX_DAC_2

config NX_DAC2_RESOLUTION_BIT_8
    bool "8-bit resolution"

config NX_DAC2_RESOLUTION_BIT_10
    bool "10-bit resolution"

config NX_DAC2_RESOLUTION_BIT_12
    bool "12-bit resolution"

config NX_DAC2_RESOLUTION_BIT_16
    bool "16-bit resolution"

endchoice

config DAC2_RESOLUTION_VALUE
    int
    default 0 if NX_DAC2_RESOLUTION_BIT_8
    default 1 if NX_DAC2_RESOLUTION_BIT_10
    default 2 if NX_DAC2_RESOLUTION_BIT_12
    default 3 if NX_DAC2_RESOLUTION_BIT_16

config DAC2_RESOLUTION
    int
    default 8 if NX_DAC2_RESOLUTION_BIT_8
    default 10 if NX_DAC2_RESOLUTION_BIT_10
    default 12 if NX_DAC2_RESOLUTION_BIT_12
    default 16 if NX_DAC2_RESOLUTION_BIT_16

config DAC2_VREF_MV
    int "DAC2 reference voltage (mV)"
    default 3300
    range 1000 5000
    help
      Reference voltage for DAC2 in millivolts.

choice
    prompt "DAC2 trigger mode"
    default NX_DAC2_TRIGGER_SOFTWARE
    depends on INSTANCE_NX_DAC_2

config NX_DAC2_TRIGGER_SOFTWARE
    bool "Software trigger"

config NX_DAC2_TRIGGER_TIMER
    bool "Timer trigger"

config NX_DAC2_TRIGGER_EXTERNAL
    bool "External trigger"

endchoice

config DAC2_TRIGGER_VALUE
    int
    default 0 if NX_DAC2_TRIGGER_SOFTWARE
    default 1 if NX_DAC2_TRIGGER_TIMER
    default 2 if NX_DAC2_TRIGGER_EXTERNAL

endif # INSTANCE_NX_DAC_2

# DAC3 Configuration
menuconfig INSTANCE_NX_DAC_3
    bool "Enable DAC3"
    default n
    depends on NATIVE_DAC_ENABLE
    help
      Enable DAC instance 3.

if INSTANCE_NX_DAC_3

config DAC3_CHANNEL_COUNT
    int "DAC3 channel count"
    default 2
    range 1 4
    help
      Number of DAC channels for DAC3.

choice
    prompt "DAC3 resolution"
    default NX_DAC3_RESOLUTION_BIT_12
    depends on INSTANCE_NX_DAC_3

config NX_DAC3_RESOLUTION_BIT_8
    bool "8-bit resolution"

config NX_DAC3_RESOLUTION_BIT_10
    bool "10-bit resolution"

config NX_DAC3_RESOLUTION_BIT_12
    bool "12-bit resolution"

config NX_DAC3_RESOLUTION_BIT_16
    bool "16-bit resolution"

endchoice

config DAC3_RESOLUTION_VALUE
    int
    default 0 if NX_DAC3_RESOLUTION_BIT_8
    default 1 if NX_DAC3_RESOLUTION_BIT_10
    default 2 if NX_DAC3_RESOLUTION_BIT_12
    default 3 if NX_DAC3_RESOLUTION_BIT_16

config DAC3_RESOLUTION
    int
    default 8 if NX_DAC3_RESOLUTION_BIT_8
    default 10 if NX_DAC3_RESOLUTION_BIT_10
    default 12 if NX_DAC3_RESOLUTION_BIT_12
    default 16 if NX_DAC3_RESOLUTION_BIT_16

config DAC3_VREF_MV
    int "DAC3 reference voltage (mV)"
    default 3300
    range 1000 5000
    help
      Reference voltage for DAC3 in millivolts.

choice
    prompt "DAC3 trigger mode"
    default NX_DAC3_TRIGGER_SOFTWARE
    depends on INSTANCE_NX_DAC_3

config NX_DAC3_TRIGGER_SOFTWARE
    bool "Software trigger"

config NX_DAC3_TRIGGER_TIMER
    bool "Timer trigger"

config NX_DAC3_TRIGGER_EXTERNAL
    bool "External trigger"

endchoice

config DAC3_TRIGGER_VALUE
    int
    default 0 if NX_DAC3_TRIGGER_SOFTWARE
    default 1 if NX_DAC3_TRIGGER_TIMER
    default 2 if NX_DAC3_TRIGGER_EXTERNAL

endif # INSTANCE_NX_DAC_3

endif # NATIVE_DAC_ENABLE
```

## platforms/native/src/flash/Kconfig
```kconfig
config NATIVE_FLASH
    bool "Enable Flash support"
    default y
    help
      Enable internal Flash peripheral support for Native platform.
      Provides simulated flash memory with erase, write, and read operations.

if NATIVE_FLASH

config NATIVE_FLASH_INSTANCES
    int "Number of Flash instances"
    default 1
    range 1 4
    help
      Number of Flash peripheral instances to create.

config NATIVE_FLASH_SECTOR_SIZE
    int "Flash sector size in bytes"
    default 4096
    help
      Size of each flash sector in bytes.

config NATIVE_FLASH_NUM_SECTORS
    int "Number of flash sectors"
    default 128
    help
      Total number of flash sectors.

config NATIVE_FLASH_PERSISTENCE
    bool "Enable flash persistence to file"
    default y
    help
      Enable saving flash contents to a file for persistence across runs.

config NATIVE_FLASH_BACKING_FILE
    string "Flash backing file path"
    default "native_flash.bin"
    depends on NATIVE_FLASH_PERSISTENCE
    help
      Path to the file used for flash persistence.

endif # NATIVE_FLASH
```
